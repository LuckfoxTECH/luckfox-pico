/*
 * SPDX-License-Identifier:     GPL-2.0+
 *
 * (C) Copyright 2022 Rockchip Electronics Co., Ltd
 */

/dts-v1/;
#include "rk3562.dtsi"
#include "rk3562-u-boot.dtsi"
#include <dt-bindings/input/input.h>

/ {
	model = "Rockchip RK3562 Evaluation Board";
	compatible = "rockchip,rk3562-evb", "rockchip,rk3562";

	adc-keys {
		compatible = "adc-keys";
		io-channels = <&saradc0 1>;
		io-channel-names = "buttons";
		keyup-threshold-microvolt = <1800000>;
		u-boot,dm-pre-reloc;
		status = "okay";

		volumeup-key {
			u-boot,dm-pre-reloc;
			linux,code = <KEY_VOLUMEUP>;
			label = "volume up";
			press-threshold-microvolt = <9>;
		};
	};
};

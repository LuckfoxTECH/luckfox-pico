/*
 * Copyright (C) 2017 Rockchip Electronics Co., Ltd
 * Author: zhihuan he <huan.he@rock-chips.com>
 * SPDX-License-Identifier:	GPL-2.0
 */

&dmc {
        rockchip,sdram-params = <
		0x3
		0x0
		0x1
		0x0
		0x0
		0x3
		0x0
		0x1
		0x1

		1
		133
		4
		1
		0

		0xc8

		0xc8
		0xc8
		0x1f4
		0x14
		0x4e
		0x4
		0x78
		0x6
		0x3
		0x0
		0x6
		0x5
		0xf
		0x15
		0x6
		0x4
		0x4
		0x6
		0x4
		0x200
		0x3
		0xa
		0x40
		0x2710
		0x1
		0x5
		0x5
		0x3
		0xc
		0x28
		0x100
		0x0
		0x4
		0x0
		0x618

		0x420
		0x40
		0x0
		0x0

		0x01
		0x60

		0x9028b18a
		0x18
		0x4a4
		0x15
	>;
};

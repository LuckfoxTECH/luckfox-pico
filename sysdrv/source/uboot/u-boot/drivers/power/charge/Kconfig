## sysdrv/source/uboot/u-boot/drivers/power/charge/Kconfig
```kconfig
config CHARGER_BQ25700
	bool "BQ25700 charger support"
	depends on DM_FUEL_GAUGE
	help
	  This adds support for BQ25700 charger support.

config CHARGER_BQ25890
	bool "BQ25890 charger support"
	depends on DM_FUEL_GAUGE
	help
	  This adds support for BQ25890 charger support.

config CHARGER_SC8551
	bool "SC8551 charger support"
	depends on DM_FUEL_GAUGE
	help
	  This adds support for sc8551 charger support.

config CHARGER_SGM41542
	bool "SGM41542 charger support"
	depends on DM_FUEL_GAUGE
	help
	  This adds support for sgm41542 charger support.
```

## sysdrv/source/uboot/u-boot/drivers/ram/Kconfig
```kconfig
config RAM
	bool "Enable RAM drivers using Driver Model"
	depends on DM
	help
	  This allows drivers to be provided for SDRAM and other RAM
	  controllers and their type to be specified in the board's device
	  tree. Generally some parameters are required to set up the RAM and
	  the RAM size can either be statically defined or dynamically
	  detected.

config SPL_RAM
	bool "Enable RAM support in SPL"
	depends on RAM && SPL_DM
	help
	  The RAM subsystem adds a small amount of overhead to the image.
	  If this is acceptable and you have a need to use RAM drivers in
	  SPL, enable this option. It might provide a cleaner interface to
	  setting up RAM (e.g. SDRAM / DDR) within SPL.

config TPL_RAM
	bool "Enable RAM support in TPL"
	depends on RAM
	help
	  The RAM subsystem adds a small amount of overhead to the image.
	  If this is acceptable and you have a need to use RAM drivers in
	  TPL, enable this option. It might provide a cleaner interface to
	  setting up RAM (e.g. SDRAM / DDR) within TPL.

config STM32_SDRAM
	bool "Enable STM32 SDRAM support"
	depends on RAM
	help
	  STM32F7 family devices support flexible memory controller(FMC) to
	  support external memories like sdram, psram & nand.
	  This driver is for the sdram memory interface with the FMC.

config DM_RAMDISK
	bool "Enable Driver Model for RAMDISK drivers"
	depends on DM
	help
	  This enables the Ramdisk uclass support. These appear as block devices
	  in U-Boot.

config RAMDISK_RO
	bool "Enable read only ramdisk support"
	depends on DM_RAMDISK
	select RKRAM_PARTITION
	help
	  This enables the read only ramdisk support.

config DM_DMC
	bool "Enable Driver Model for DMC drivers"
	depends on DM
	help
	  This config enables the driver-model DMC support.

source "drivers/ram/rockchip/Kconfig"
```

## sysdrv/source/uboot/u-boot/drivers/sysreset/Kconfig
```kconfig
#
# System reset devices
#

menu "System reset device drivers"

config SYSRESET
	bool "Enable support for system reset drivers"
	depends on DM
	help
	  Enable system reset drivers which can be used to reset the CPU or
	  board. Each driver can provide a reset method which will be called
	  to effect a reset. The uclass will try all available drivers when
	  reset_walk() is called.

config SPL_SYSRESET
	bool "Enable support for system reset drivers in SPL mode"
	depends on SYSRESET && SPL_DM
	help
	  Enable system reset drivers which can be used to reset the CPU or
	  board. Each driver can provide a reset method which will be called
	  to effect a reset. The uclass will try all available drivers when
	  reset_walk() is called.

config TPL_SYSRESET
	bool "Enable support for system reset drivers in TPL mode"
	depends on SYSRESET && TPL_DM
	help
	  Enable system reset drivers which can be used to reset the CPU or
	  board. Each driver can provide a reset method which will be called
	  to effect a reset. The uclass will try all available drivers when
	  reset_walk() is called.

config SYSRESET_REG
	hex "The sysreset register for the sysreset"
	depends on !SYSRESET
	default 0xff490408

config SYSRESET_VAL
	hex "The sysreset value for the sysreset"
	depends on !SYSRESET
	default 0x0000fdb9

if SYSRESET

config SYSRESET_PSCI
	bool "Enable support for PSCI System Reset"
	depends on ARM_PSCI_FW
	default y if ARCH_ROCKCHIP
	help
	  Enable PSCI SYSTEM_RESET function call.  To use this, PSCI firmware
	  must be running on your system.

endif

config SYSRESET_SYSCON
	bool "Enable support for mfd syscon reboot driver"
	select REGMAP
	select SYSCON
	help
	  Reboot support for generic SYSCON mapped register reset.

config SYSRESET_SYSCON_REBOOT
	bool "Enable support for syscon reboot mode driver"
	default y if ARCH_ROCKCHIP
	help
	  Reboot mode command, like: reboot bootloader, etc.

config SYSRESET_WATCHDOG
	bool "Enable support for watchdog reboot driver"
	select WDT
	help
	  Reboot support for generic watchdog reset.

endmenu
```

## sysdrv/source/uboot/u-boot/drivers/video/drm/Kconfig
```kconfig
menuconfig DRM_ROCKCHIP
	bool "Rockchip DRM Support"
	depends on DM_VIDEO && OF_LIVE
	select VIDEO_BRIDGE
	select PHY
	help
	  Rockchip SoCs provide video output capabilities for High-Definition
	  Multimedia Interface (HDMI), Low-voltage Differential Signalling
	  (LVDS), embedded DisplayPort (eDP) and Display Serial Interface (DSI).

	  This driver supports the on-chip video output device, and targets the
	  Rockchip RK3288 and RK3399.

config DRM_MEM_RESERVED_SIZE_MBYTES
	int "Size in Mega Bytes"
	depends on DRM_ROCKCHIP
	default 32

config DRM_DP_HELPER
	bool
	depends on DRM_ROCKCHIP

config DRM_MAXIM_MAX96745
	bool "Maxim max96745 GMSL2 Serializer"
	depends on DRM_ROCKCHIP
	select I2C_MUX_MAX96745
	select PINCTRL_MAX96745
	help
	  Driver for Maxim MAX96745 GMSL2 Serializer with eDP1.4a/DP1.4 Input.

config DRM_MAXIM_MAX96755F
	bool "Maxim max96755F GMSL2 Serializer"
	depends on DRM_ROCKCHIP
	select I2C_MUX_MAX96755F
	select PINCTRL_MAX96755F
	help
	  Driver for Maxim MAX96755F GMSL2 Serializer with MIPI-DSI Input.

config DRM_PANEL_ROHM_BU18RL82
	bool "Rohm BU18RL82-based panels"
	depends on DRM_ROCKCHIP
	help
	  Say Y if you want to enable support for panels based on the
	  Rohm BU18RL82.

config DRM_PANEL_MAXIM_MAX96752F
	bool "Maxim MAX96752F-based panels"
	depends on DRM_ROCKCHIP
	help
	  Say Y if you want to enable support for panels based on the
	  Maxim MAX96752F.

config DRM_ROCKCHIP_PANEL
	bool "Rockchip Panel Support"
	depends on DRM_ROCKCHIP
	select DRM_MIPI_DSI

config DRM_ROHM_BU18XL82
	bool "ROHM clockless serializer BU18TL82 and  deserializer BU18RL82"
	depends on DRM_ROCKCHIP && I2C_MUX
	help
	  Driver for ROHM clockless serdes with MIPI or LVDS Input.

config DRM_ROCKCHIP_DW_HDMI
	bool "Rockchip specific extensions for Synopsys DW HDMI"
	depends on DRM_ROCKCHIP
	help
	 This selects support for Rockchip SoC specific extensions
	 for the Synopsys DesignWare HDMI driver. If you want to
	 enable HDMI on, you should selet this option.

config DRM_ROCKCHIP_DW_HDMI_QP
	bool "Rockchip specific extensions for Synopsys DW HDMI QP"
	depends on DRM_ROCKCHIP
	help
	 This selects support for Rockchip SoC specific extensions
	 for the Synopsys DesignWare HDMI QP driver. If you want to
	 enable HDMI on, you should select this option.

config DRM_ROCKCHIP_INNO_HDMI
	bool "Rockchip specific extensions for INNO HDMI"
	depends on DRM_ROCKCHIP
	help
	 This selects support for Rockchip SoC specific extensions
	 for the Synopsys DesignWare HDMI driver. If you want to
	 enable HDMI on, you should selet this option.

config ROCKCHIP_INNO_HDMI_PHY
	bool "Rockchip specific extensions for INNO HDMI PHY"
	depends on DRM_ROCKCHIP
	help
	 This selects support for INNO HDMI PHY. If you want to
	 use HDMI or TVE in RK322XH or RK322X, you should selet
	 this option.

config DRM_ROCKCHIP_INNO_MIPI_PHY
	tristate "Rockchip INNO MIPI PHY driver"
	depends on DRM_ROCKCHIP
	help
	  Enable this to support the Rockchip MIPI PHY
	  with Innosilicon IP block.

config DRM_ROCKCHIP_INNO_VIDEO_PHY
	tristate "Rockchip INNO LVDS/TTL PHY driver"
	depends on DRM_ROCKCHIP
	help
	  Enable this to support the Rockchip LVDS/TTL PHY
	  with Innosilicon IP block.

config DRM_ROCKCHIP_INNO_VIDEO_COMBO_PHY
	tristate "Rockchip INNO MIPI/LVDS/TTL PHY driver"
	depends on DRM_ROCKCHIP
	help
	  Enable this to support the Rockchip MIPI/LVDS/TTL PHY
	  with Innosilicon IP block.

config DRM_MIPI_DSI
	bool
	depends on DRM_ROCKCHIP

config DRM_DSC
	bool
	depends on DRM_ROCKCHIP

config DRM_ROCKCHIP_DW_MIPI_DSI
	tristate "Rockchip specific extensions for Synopsys DW MIPI DSI"
	depends on DRM_ROCKCHIP
	select DRM_MIPI_DSI
	select DRM_ROCKCHIP_PANEL
	help
	 This selects support for Rockchip SoC specific extensions
	 for the Synopsys DesignWare HDMI driver. If you want to
	 enable MIPI DSI on RK3288 based SoC, you should selet this
	 option.

config DRM_ROCKCHIP_DW_MIPI_DSI2
	tristate "Rockchip specific extensions for Synopsys DW MIPI DSI2"
	depends on DRM_ROCKCHIP
	select DRM_MIPI_DSI
	select DRM_DSC
	select DRM_ROCKCHIP_PANEL
	help
	 This selects support for Rockchip SoC specific extensions
	 for the Synopsys DesignWare MIPI DSI2 driver. If you want to
	 enable MIPI DSI2 on RK3588 based SoC, you should selet this
	 option.

config DRM_ROCKCHIP_DW_DP
	bool "Rockchip specific extensions for Synopsys DW DP driver"
	depends on DRM_ROCKCHIP
	select DRM_DP_HELPER
	help
	  This selects support for Rockchip SoC specific extensions
	  for the Synopsys DW DP driver. If you want to enable DP
	  on RK3588 based SoC, you should select this option.

config DRM_ROCKCHIP_ANALOGIX_DP
	bool "Rockchip specific extensions for Analogix DP driver"
	depends on DRM_ROCKCHIP
	select DRM_ROCKCHIP_PANEL
	select DRM_DP_HELPER
	help
	  This selects support for Rockchip SoC specific extensions
	  for the Analogix Core DP driver. If you want to enable DP
	  on RK3288 based SoC, you should selet this option.

config DRM_ROCKCHIP_LVDS
	bool "Rockchip LVDS Support"
	depends on DRM_ROCKCHIP
	select DRM_ROCKCHIP_PANEL
	help
	  Choose this option to enable support for Rockchip LVDS controllers.
	  Rockchip rk3288 SoC has LVDS TX Controller can be used, and it
	  support LVDS, rgb, dual LVDS output mode. say Y to enable its
	  driver.

config DRM_ROCKCHIP_RGB
	bool "Rockchip RGB Support"
	depends on DRM_ROCKCHIP
	select DRM_ROCKCHIP_PANEL
	help
	  Choose this option to enable support for Rockchip RGB driver.
	  say Y to enable its driver.

config DRM_ROCKCHIP_RK618
	bool "Rockchip RK618 display bridge driver"
	depends on DRM_ROCKCHIP
	select DRM_ROCKCHIP_PANEL
	select VIDEO_BRIDGE
	help
	  Choose this option to enable support for Rockchip RK618 display
	  bridge chips driver. say Y to enable its driver.

config DRM_ROCKCHIP_RK1000
	bool "Rockchip RK1000 display bridge driver"
	depends on DRM_ROCKCHIP
	select DRM_ROCKCHIP_PANEL
	select VIDEO_BRIDGE
	help
	  Choose this option to enable support for Rockchip RK1000 display
	  bridge chips driver. say Y to enable its driver.

config DRM_ROCKCHIP_SAMSUNG_MIPI_DCPHY
	tristate "Rockchip SAMSUNG MIPI DCPHY driver"
	depends on DRM_ROCKCHIP
	help
	  Enable this to support the Rockchip MIPI DCPHY
	  with SAMSUNG IP block.

config PHY_ROCKCHIP_SAMSUNG_HDPTX_HDMI
	bool "Rockchip Samsung HDMI/DP Combo PHY HDMI driver"
	depends on DRM_ROCKCHIP
	select LIB_RATIONAL
	help
	  Support for Rockchip HDMI/DP Combo PHY HDMI with Samsung
	  IP block.

config DRM_ROCKCHIP_TVE
	bool "Rockchip TVE Support"
	depends on DRM_ROCKCHIP
	help
	  Choose this option to enable support for Rockchip TVE.
	  Say Y to enable TVE driver.

config ROCKCHIP_CUBIC_LUT_SIZE
	int "Rockchip cubic lut size"
	depends on DRM_ROCKCHIP
	default 0
	help
	  Used to calc cubic lut size.

config DRM_SII902X
	bool "Silicon Image sii902x RGB/HDMI bridge"
	depends on DRM_ROCKCHIP
	help
	  Silicon Image sii902x bridge chip driver.

source "drivers/video/drm/display-serdes/Kconfig"
```

## sysdrv/source/uboot/u-boot/drivers/video/drm/display-serdes/Kconfig
```kconfig
#
#(C) Copyright 2023-2025 Rockchip Electronics Co., Ltd
#
# SPDX-License-Identifier: GPL-2.0-only
#
# Multifunction miscellaneous devices
#
comment "driver for different display serdes"

menuconfig SERDES_DISPLAY
	tristate "rockchip display serdes drivers support"
	select SERDES_DISPLAY_CHIP_ROHM
	select SERDES_DISPLAY_CHIP_MAXIM
	select SERDES_DISPLAY_CHIP_ROCKCHIP
	select SERDES_DISPLAY_CHIP_NOVO
	select I2C_MUX
	select DRM_ROCKCHIP
	default n
	help
	  This driver supports different serdes devices from different vendor such as
	  maxim, rohm, rockchip etc.

if SERDES_DISPLAY
source "drivers/video/drm/display-serdes/maxim/Kconfig"
source "drivers/video/drm/display-serdes/rohm/Kconfig"
source "drivers/video/drm/display-serdes/rockchip/Kconfig"
source "drivers/video/drm/display-serdes/novo/Kconfig"
endif
```

## sysdrv/source/uboot/u-boot/drivers/video/rk_eink/Kconfig
```kconfig
config ROCKCHIP_EBC_TCON
        bool "Rockchip ebc tcon Support"
        depends on ROCKCHIP_EINK
        help
           Choose this option to enable support for EBC TCON controller

config ROCKCHIP_TPS65185
        bool "TPS65185 Support"
        depends on ROCKCHIP_EINK
        help
           Choose this option to enable support for TPS65185, which is
           used to supply power for eink panel.

config ROCKCHIP_EINK_DISPLAY
        bool "Rockchip EINK DISPLAY Support"
        depends on ROCKCHIP_EINK
        help
           Choose this option to enable support for eink display, which is
           used to display uboot/charging/lowerpower logo, and also used to
           load kernel logo to ram, which can pass to kernel to display.
```

## sysdrv/source/uboot/u-boot/lib/rsa/Kconfig
```kconfig
config RSA
	bool "Use RSA Library"
	select RSA_FREESCALE_EXP if FSL_CAAM && !ARCH_MX7 && !ARCH_MX6 && !ARCH_MX5
	select RSA_SOFTWARE_EXP if !RSA_FREESCALE_EXP
	help
	  RSA support. This enables the RSA algorithm used for FIT image
	  verification in U-Boot.
	  See doc/uImage.FIT/signature.txt for more details.
	  The Modular Exponentiation algorithm in RSA is implemented using
	  driver model. So CONFIG_DM needs to be enabled by default for this
	  library to function.
	  The signing part is build into mkimage regardless of this
	  option. The software based modular exponentiation is built into
	  mkimage irrespective of this option.

config SPL_RSA
	bool "Use RSA Library within SPL"
	depends on RSA

if RSA
config RSA_SOFTWARE_EXP
	bool "Enable driver for RSA Modular Exponentiation in software"
	depends on DM && RSA
	help
	  Enables driver for modular exponentiation in software. This is a RSA
	  algorithm used in FIT image verification. It required RSA Key as
	  input.
	  See doc/uImage.FIT/signature.txt for more details.

config RSA_FREESCALE_EXP
	bool "Enable RSA Modular Exponentiation with FSL crypto accelerator"
	depends on DM && RSA && FSL_CAAM && !ARCH_MX7 && !ARCH_MX6 && !ARCH_MX5
	help
	Enables driver for RSA modular exponentiation using Freescale cryptographic
	accelerator - CAAM.

config RSA_N_SIZE
	hex "Define the RSA N size"
	help
	  The value is depended on different platforms. The RV1126/RV1109 is set to 0x100.
	  The RK3568/RK3566 is set to 0x200.

config RSA_E_SIZE
	hex "Define the RSA E size"
	help
	  The value is depended on different platforms. The RV1126/RV1109 is set to 0x100.
	  The RK3568/RK3566 is set to 0x10.

config RSA_C_SIZE
	hex "Define the RSA C size"
	help
	  The value is depended on different platforms.The RV1126/RV1109 is set to 0x14.
	  The RK3568/RK3566 is set to 0x20.

endif
```

## sysdrv/source/uboot/u-boot/configs/rv1106_defconfig
```kconfig
CONFIG_ARM=y
CONFIG_ARCH_ROCKCHIP=y
CONFIG_SPL_GPIO_SUPPORT=y
CONFIG_SPL_LIBCOMMON_SUPPORT=y
CONFIG_SPL_LIBGENERIC_SUPPORT=y
CONFIG_SYS_MALLOC_F_LEN=0x80000
CONFIG_SPL_FIT_GENERATOR="arch/arm/mach-rockchip/make_fit_uboot.sh"
CONFIG_ROCKCHIP_RV1106=y
CONFIG_ROCKCHIP_SPL_RESERVE_IRAM=0x0
CONFIG_ROCKCHIP_FIT_IMAGE=y
CONFIG_USING_KERNEL_DTB_V2=y
CONFIG_ROCKCHIP_FIT_IMAGE_PACK=y
CONFIG_SPL_SERIAL_SUPPORT=y
CONFIG_SPL_DRIVERS_MISC_SUPPORT=y
CONFIG_TARGET_EVB_RV1106=y
CONFIG_SPL_LIBDISK_SUPPORT=y
CONFIG_SPL_SPI_FLASH_SUPPORT=y
CONFIG_SPL_SPI_SUPPORT=y
CONFIG_DEFAULT_DEVICE_TREE="rv1106-evb"
CONFIG_DEBUG_UART=y
# CONFIG_DISTRO_DEFAULTS is not set
CONFIG_ANDROID_BOOT_IMAGE=y
CONFIG_FIT=y
CONFIG_FIT_IMAGE_POST_PROCESS=y
CONFIG_FIT_HW_CRYPTO=y
CONFIG_SPL_LOAD_FIT=y
CONFIG_SPL_FIT_IMAGE_POST_PROCESS=y
CONFIG_SPL_FIT_HW_CRYPTO=y
# CONFIG_SPL_SYS_DCACHE_OFF is not set
CONFIG_SPL_FIT_IMAGE_KB=256
CONFIG_SPL_FIT_IMAGE_MULTIPLE=1
CONFIG_BOOTDELAY=0
CONFIG_SYS_CONSOLE_INFO_QUIET=y
# CONFIG_DISPLAY_CPUINFO is not set
CONFIG_ANDROID_BOOTLOADER=y
CONFIG_ANDROID_BOOT_IMAGE_HASH=y
# CONFIG_SKIP_RELOCATE_UBOOT is not set
CONFIG_SPL_BOARD_INIT=y
# CONFIG_SPL_RAW_IMAGE_SUPPORT is not set
# CONFIG_SPL_LEGACY_IMAGE_SUPPORT is not set
CONFIG_SYS_MMCSD_RAW_MODE_U_BOOT_USE_PARTITION=y
CONFIG_SPL_MMC_WRITE=y
CONFIG_SPL_MTD_SUPPORT=y
CONFIG_SPL_OPTEE=y
CONFIG_HUSH_PARSER=y
# CONFIG_CMD_BDI is not set
# CONFIG_CMD_CONSOLE is not set
CONFIG_CMD_BOOTZ=y
# CONFIG_CMD_ELF is not set
# CONFIG_CMD_IMI is not set
# CONFIG_CMD_IMLS is not set
# CONFIG_CMD_XIMG is not set
# CONFIG_CMD_CRC32 is not set
# CONFIG_CMD_FLASH is not set
# CONFIG_CMD_FPGA is not set
CONFIG_RANDOM_UUID=y
# CONFIG_CMD_LOADB is not set
# CONFIG_CMD_LOADS is not set
CONFIG_CMD_BOOT_ANDROID=y
CONFIG_CMD_MMC=y
CONFIG_CMD_MTD=y
CONFIG_CMD_PART=y
# CONFIG_CMD_ITEST is not set
CONFIG_CMD_SCRIPT_UPDATE=y
# CONFIG_CMD_SOURCE is not set
# CONFIG_CMD_SETEXPR is not set
CONFIG_CMD_TFTP_BOOTM=y
CONFIG_CMD_TFTP_FLASH=y
CONFIG_CMD_DHCP=y
# CONFIG_CMD_NFS is not set
CONFIG_CMD_PING=y
# CONFIG_CMD_MISC is not set
CONFIG_CMD_FAT=y
# CONFIG_SPL_DOS_PARTITION is not set
CONFIG_SPL_OF_CONTROL=y
CONFIG_SPL_DTB_MINIMUM=y
CONFIG_OF_LIVE=y
CONFIG_OF_SPL_REMOVE_PROPS="interrupt-parent assigned-clocks assigned-clock-rates assigned-clock-parents"
CONFIG_OF_U_BOOT_REMOVE_PROPS="interrupt-parent"
CONFIG_ENVF=y
CONFIG_ENVF_LIST="blkdevparts mtdparts sys_bootargs app reserved ipaddr serverip netmask gatewayip ethaddr"
CONFIG_REGMAP=y
CONFIG_SPL_REGMAP=y
CONFIG_SYSCON=y
CONFIG_SPL_SYSCON=y
# CONFIG_SARADC_ROCKCHIP is not set
CONFIG_SARADC_ROCKCHIP_V2=y
CONFIG_CLK=y
CONFIG_SPL_CLK=y
CONFIG_DM_CRYPTO=y
CONFIG_SPL_DM_CRYPTO=y
CONFIG_ROCKCHIP_CRYPTO_V2=y
CONFIG_SPL_ROCKCHIP_CRYPTO_V2=y
CONFIG_DM_RNG=y
CONFIG_RNG_ROCKCHIP=y
CONFIG_ROCKCHIP_GPIO=y
# CONFIG_DM_I2C is not set
CONFIG_DM_KEY=y
CONFIG_ADC_KEY=y
CONFIG_MISC=y
CONFIG_SPL_MISC=y
CONFIG_ROCKCHIP_OTP=y
CONFIG_SPL_ROCKCHIP_SECURE_OTP=y
# CONFIG_SUPPORT_EMMC_RPMB is not set
CONFIG_MMC_DW=y
CONFIG_MMC_DW_ROCKCHIP=y
CONFIG_MTD=y
CONFIG_MTD_BLK=y
CONFIG_MTD_DEVICE=y
CONFIG_MTD_SPI_NAND=y
CONFIG_SPI_FLASH=y
CONFIG_SF_DEFAULT_MODE=0x3
CONFIG_SPI_FLASH_GIGADEVICE=y
CONFIG_SPI_FLASH_MACRONIX=y
CONFIG_SPI_FLASH_WINBOND=y
CONFIG_SPI_FLASH_XMC=y
CONFIG_SPI_FLASH_XTX=y
CONFIG_SPI_FLASH_MTD=y
CONFIG_PHY_RK630=y
CONFIG_DM_ETH=y
CONFIG_DM_ETH_PHY=y
CONFIG_DWC_ETH_QOS=y
# CONFIG_DWC_ETH_QOS_FULL is not set
CONFIG_GMAC_ROCKCHIP=y
CONFIG_PINCTRL=y
CONFIG_SPL_PINCTRL=y
# CONFIG_DM_REGULATOR is not set
# CONFIG_DM_PWM is not set
CONFIG_RAM=y
CONFIG_TPL_RAM=y
CONFIG_ROCKCHIP_SDRAM_COMMON=y
CONFIG_DM_RESET=y
CONFIG_DEBUG_UART_BASE=0xff4c0000
CONFIG_DEBUG_UART_CLOCK=24000000
CONFIG_DEBUG_UART_SHIFT=2
CONFIG_ROCKCHIP_SFC=y
CONFIG_SYSRESET=y
# CONFIG_SYSRESET_SYSCON_REBOOT is not set
# CONFIG_FAT_WRITE is not set
CONFIG_USE_TINY_PRINTF=y
# CONFIG_REGEX is not set
CONFIG_SPL_TINY_MEMSET=y
CONFIG_RSA=y
CONFIG_SPL_RSA=y
CONFIG_RSA_N_SIZE=0x200
CONFIG_RSA_E_SIZE=0x10
CONFIG_RSA_C_SIZE=0x20
CONFIG_SPL_LZMA=y
CONFIG_SPL_GZIP=y
CONFIG_ERRNO_STR=y
# CONFIG_EFI_LOADER is not set
```

## sysdrv/source/uboot/u-boot/drivers/cpu/Kconfig
```kconfig
config CPU
	bool "Enable CPU drivers using Driver Model"
	help
	  This allows drivers to be provided for CPUs and their type to be
	  specified in the board's device tree. For boards which support
	  multiple CPUs, then normally have to be set up in U-Boot so that
	  they can work correctly in the OS. This provides a framework for
	  finding out information about available CPUs and making changes.

config AMP
	bool "Enable AMP drivers using Driver Model"
	help
	  This support Asymmetric Multi-Processing, cpus can run on different
	  firmware.

config ROCKCHIP_AMP
	bool "Enable Rockchip AMP driver"
	depends on AMP && ROCKCHIP_SMCCC && RKIMG_BOOTLOADER
	help
	  This enable Rockchip AMP driver support.
```

## sysdrv/source/uboot/u-boot/drivers/cpu/amp.its
```
/*
 * Copyright (C) 2021 Fuzhou Rockchip Electronics Co., Ltd
 *
 * SPDX-License-Identifier: GPL-2.0
 */

/dts-v1/;
/ {
	description = "Rockchip AMP FIT Image";
	#address-cells = <1>;

	images {
		/* ARM cortex-A core */
		amp1 {
			description  = "bare-mental-core1";
			data         = /incbin/("./amp1.bin");
			type         = "firmware";	// must be "firmware"
			compression  = "none";
			arch         = "arm";		// "arm64" or "arm", the same as U-Boot state
			cpu          = <0x100>;		// mpidr
			thumb        = <0>;		// 0: arm or thumb2; 1: thumb
			hyp          = <0>;		// 0: el1/svc; 1: el2/hyp
			load         = <0x01800000>;
			udelay       = <1000000>;
			hash {
				algo = "sha256";
			};
		};

		amp2 {
			description  = "bare-mental-core2";
			data         = /incbin/("./amp2.bin");
			type         = "firmware";
			compression  = "none";
			arch         = "arm";
			cpu          = <0x200>;
			thumb        = <0>;
			hyp          = <0>;
			load         = <0x03800000>;
			udelay       = <1000000>;
			hash {
				algo = "sha256";
			};
		};

		amp3 {
			description  = "bare-mental-core3";
			data         = /incbin/("./amp3.bin");
			type         = "firmware";
			compression  = "none";
			arch         = "arm";
			cpu          = <0x300>;
			thumb        = <0>;
			hyp          = <0>;
			load         = <0x05800000>;
			udelay       = <1000000>;
			hash {
				algo = "sha256";
			};
		};

		/* Other core */
		amp4 {
			description  = "standalone-mcu1";
			data         = /incbin/("./mcu1.bin");
			type         = "standalone";	// must be "standalone"
			compression  = "none";
			arch         = "arm";		// "arm64" or "arm", the same as U-Boot state
			load         = <0x06800000>;
			udelay       = <1000000>;
			hash {
				algo = "sha256";
			};
		};
	};

	configurations {
		default = "conf";
		conf {
			description = "Rockchip AMP images";
			rollback-index = <0x0>;
			loadables = "amp1", "amp2", "amp3", "amp4";

			signature {
				algo = "sha256,rsa2048";
				padding = "pss";
				key-name-hint = "dev";
				sign-images = "loadables";
			};

			/* - run linux on cpu0
			 * - it is brought up by amp(that run on U-Boot)
			 * - it is boot entry depends on U-Boot
			 */
			linux {
				description  = "linux-os";
				arch         = "arm64";
				cpu          = <0x000>;
				thumb        = <0>;
				hyp          = <0>;
				udelay       = <1000000>;
				load         = <0x2000000>; // optional
				load_c       = <0x4000000>; // optional
			};
		};
	};
};
```

## sysdrv/source/uboot/u-boot/drivers/crypto/Kconfig
```kconfig
menu "Hardware crypto devices"

config DM_CRYPTO
	bool "Enable Driver Model for CRYPTO drivers (UCLASS_CRYPTO)"
	depends on DM
	---help---
	This config enables the dm crypto support.

config SPL_DM_CRYPTO
	bool "Enable Driver Model for CRYPTO drivers in spl"
	depends on SPL_DM
	---help---
	This config enables the dm crypto support.

source drivers/crypto/fsl/Kconfig
source drivers/crypto/rockchip/Kconfig

endmenu
```

## sysdrv/source/uboot/u-boot/drivers/firmware/Kconfig
```kconfig
config FIRMWARE
	bool

config ARM_PSCI_FW
	bool
	select FIRMWARE

source "drivers/firmware/scmi/Kconfig"
```

## sysdrv/source/uboot/u-boot/drivers/input/Kconfig
```kconfig
config INPUT
	bool "Enable input subsystem"
	depends on DM
	default y

config SPL_INPUT
	bool "Enable input subsystem for SPL"
	depends on SPL_DM

config TPL_INPUT
	bool "Enable input subsystem for TPL"
	depends on TPL_DM

config DM_KEYBOARD
	bool "Enable driver model keyboard support"
	depends on DM
	help
	  This adds a uclass for keyboards and implements keyboard support
	  using driver model. The API is implemented by keyboard.h and
	  includes methods to start/stop the device, check for available
	  input and update LEDs if the keyboard has them.

config DM_KEY
	bool "Enable driver model key support"
	depends on DM
	help
	  This adds a simple uclass for key.

config DM_RC
	bool "Enable driver model Remote Controller support"
	depends on DM
	help
	  This adds a uclass for Remote Controllers. This is needed
	  in order to support standalone IR receivers.

config RK_IR
	bool "Enable rk ir support"
	depends on DM_RC
	select BITREVERSE
	help
	  This adds a driver for the rockchip IR controller.

config SPL_DM_KEYBOARD
	bool "Enable driver model keyboard support"
	depends on SPL_DM
	help
	  This adds a uclass for keyboards and implements keyboard support
	  using driver model. The API is implemented by keyboard.h and
	  includes methods to start/stop the device, check for available
	  input and update LEDs if the keyboard has them.

config TPL_DM_KEYBOARD
	bool "Enable driver model keyboard support"
	depends on TPL_DM
	help
	  This adds a uclass for keyboards and implements keyboard support
	  using driver model. The API is implemented by keyboard.h and
	  includes methods to start/stop the device, check for available
	  input and update LEDs if the keyboard has them.

config CROS_EC_KEYB
	bool "Enable Chrome OS EC keyboard support"
	depends on INPUT
	help
	  Most ARM Chromebooks use an EC to provide access to the keyboard.
	  Messages are used to request key scans from the EC and these are
	  then decoded into keys by this driver.

config SPL_CROS_EC_KEYB
	bool "Enable Chrome OS EC keyboard support in SPL"
	depends on SPL_INPUT
	help
	  Most ARM Chromebooks use an EC to provide access to the keyboard.
	  Messages are used to request key scans from the EC and these are
	  then decoded into keys by this driver.

config TPL_CROS_EC_KEYB
	bool "Enable Chrome OS EC keyboard support in TPL"
	depends on TPL_INPUT
	help
	  Most ARM Chromebooks use an EC to provide access to the keyboard.
	  Messages are used to request key scans from the EC and these are
	  then decoded into keys by this driver.

config I8042_KEYB
	bool "Enable Intel i8042 keyboard support"
	depends on DM_KEYBOARD
	default X86
	help
	  This adds a driver for the i8042 keyboard controller, allowing the
	  keyboard to be used on devices which support this controller. The
	  driver handles English and German keyboards - set the environment
	  variable 'keymap' to "de" to select German. Keyboard repeat is
	  handled by the keyboard itself.

config RK8XX_PWRKEY
	bool "Enable RK805/rk806/816/817 pwrkey support"
	depends on DM_KEY && (PMIC_RK8XX || PMIC_SPI_RK8XX) && IRQ
	help
	  This adds a driver for the RK805/816/817 pwrkey support.

config ADC_KEY
	bool "Enable adc keys support"
	depends on DM_KEY
	help
	  This adds a driver for the adc keys support.

config SPL_ADC_KEY
        bool "Enable SPL adc keys support without DM"
        depends on SPL_INPUT
        help
          This adds a driver for the SPL adc keys support

config GPIO_KEY
	bool "Enable gpio keys support"
	depends on DM_KEY
	help
	  This adds a driver for the gpio keys support.

config RK_KEY
	bool "Enable rk keys support"
	depends on DM_KEY
	help
	  This adds a driver for the rk keys support.

config PWRKEY_DNL_TRIGGER_NUM
	int "Enter download mode by pwrkey trigger count"
	default 0
	depends on DM_KEY && IRQ
	help
	  This support enter download mode by press and release pwrkey for times
	  over the trigger count. The default value 0 means disabled.
```

## sysdrv/source/uboot/u-boot/drivers/mtd/nand/Kconfig
```kconfig
config MTD_NAND_CORE
	tristate

config MTD_NAND_BBT_USING_FLASH
	bool "Mtd Nand BBT using flash management strategy"
	default n
	help
	  This is a simple flash BBT management strategy for Nand devices.

	  Say Y when you want to use BBT in flash.

source "drivers/mtd/nand/raw/Kconfig"

source "drivers/mtd/nand/spi/Kconfig"
```

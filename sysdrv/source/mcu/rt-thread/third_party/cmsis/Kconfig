## sysdrv/source/mcu/rt-thread/third_party/cmsis/Kconfig
```kconfig
config PKG_CMSIS_RTOS2
    bool "CMSIS RTOS2 API with RT-Thread porting"
    default n
```

## sysdrv/source/mcu/rt-thread/third_party/cypress/Kconfig
```kconfig
menuconfig RT_USING_CYPRESS
    bool "support cyress modules"
    default n

if RT_USING_CYPRESS
    config RT_CYPRESS_WIFI
    bool "enable cyress wifi"
        default y
    if RT_CYPRESS_WIFI
        config RT_CYPRESS_WIFI_SDIO
            depends on RT_CYPRESS_WIFI
            select RT_USING_WIFI
            select RT_USING_SDIO
            select RT_USING_SDIO0
            select RT_USING_LWIP
            select RT_WLAN_PROT_LWIP_PBUF_FORCE
            bool "Enable cypress wifi for sdio interface"
            default n

        config RT_CYPRESS_WIFI_SPI
            depends on RT_CYPRESS_WIFI
            select RT_USING_WIFI
            select RT_USING_SPI
            select RT_USING_SPI2
            select RT_USING_LWIP
            select RT_USING_LWIP141
            select RT_WLAN_PROT_LWIP_PBUF_FORCE
            bool "Enable cypress wifi for spi interface"
            default n
	endif

    config RT_CYPRESS_BT
        select RT_USING_POSIX_TERMIOS
        bool "Enable cypress bt"
        default n
    if RT_CYPRESS_BT
        source "$RTT_DIR/third_party/cypress/bsp/bt/Kconfig"
    endif
endif
```

## sysdrv/source/mcu/rt-thread/third_party/cypress/bsp/bt/Kconfig
```kconfig
config BT_DEV_MODE
    bool "Internal development mode"
    default n

config BT_BUILD_VERBOSE
    bool "trace build information "
    default n

config BT_AUDIO_DEVICE
    string "play device"
    default "es8388p"

config BT_MIC_DEVICE
    string "recorder device"
    default "pdmc"

config BT_UART_NAME
    string "setup uart name for HCI Bluetooth"
    default "/dev/uart2"

config BT_FACTORY_TEST
    bool "enable Bluetooth Factory test command"
    default n

menuconfig CY_BT_DEMO_APP
    bool "choose one desired DEMO"
    default y
    if CY_BT_DEMO_APP
        choice
            prompt "Select Demo APP"
            default DEMO_HF_A2DP

            config DEMO_BLE_SENSOR
                bool "Hello Sensor demo"

            config DEMO_BLE_CLIENT
                bool "Hello Client demo"

            config DEMO_BLE_CLIENT_SERVER 
                bool "Hello Client Server demo"

            config DEMO_HF_A2DP
                bool "A2DP+HF"

            config DEMO_SPP_BLE
                bool "SPP server & BLE server"

            config DEMO_AVK
                bool "A2DP & AVRCP"

        endchoice
    endif
```

## sysdrv/source/mcu/rt-thread/third_party/netutils/Kconfig
```kconfig
menuconfig RT_USING_NETUTILS
    bool "netutils: Networking utilities for RT-Thread"
    depends on !PKG_USING_NETUTILS
    default n

if RT_USING_NETUTILS

    config RT_NETUTILS_PING
        bool "Enable Ping utility"
        depends on (!RT_USING_NETDEV && RT_USING_LWIP && !PKG_NETUTILS_PING)
        select RT_LWIP_ICMP
        select RT_LWIP_RAW
        default n

    config RT_NETUTILS_TFTP
        bool "Enable TFTP(Trivial File Transfer Protocol) server"
        default n
        depends on (RT_USING_LWIP && !PKG_NETUTILS_TFTP)
    if RT_NETUTILS_TFTP
        config NETUTILS_TFTP_PORT
            int "TFTP server port"
            range 0 65535
            default 69
    endif

    config RT_NETUTILS_IPERF
        bool "Enable iperf-liked network performance tool"
        depends on !PKG_NETUTILS_IPERF
        select RT_USING_LIBC
        select RT_USING_SAL
        select SAL_USING_POSIX
        default n

    config RT_NETUTILS_NETIO
        bool "Enable NetIO network throughput performance tool"
        default n
        depends on (RT_USING_LWIP && !PKG_NETUTILS_NETIO)

    config RT_NETUTILS_NTP
        bool "Enable NTP(Network Time Protocol) client"
        depends on !PKG_NETUTILS_NTP
        select RT_USING_SAL
        default n
    if RT_NETUTILS_NTP
        config NETUTILS_NTP_TIMEZONE
            int "Timezone for calculate local time"
            range -12 12
            default 8

        config NETUTILS_NTP_HOSTNAME
            string "NTP server name1"
            default "cn.ntp.org.cn"

        config NETUTILS_NTP_HOSTNAME2
            string "NTP server name2"
            default "ntp.rt-thread.org"

        config NETUTILS_NTP_HOSTNAME3
            string "NTP server name3"
            default "edu.ntp.org.cn"
    endif

    config RT_NETUTILS_TELNET
        depends on !PKG_NETUTILS_TELNET
        bool "Enable Telnet server"
        default n

    config RT_NETUTILS_TCPDUMP
        bool "Enable tcpdump tool"
        depends on (RT_USING_LWIP && !PKG_NETUTILS_TCPDUMP)
        select RT_USING_OPTPARSE
        select RT_USING_DFS
        help
            Select the tcpdump tool

    if RT_NETUTILS_TCPDUMP
        config PKG_NETUTILS_TCPDUMP_PRINT
            bool "Enable tcpdump pcap data to print on the console"
            default n
            help
                Enable tcpdump pcap data to print on the console

        config PKG_NETUTILS_TCPDUMP_DBG
            bool "Enable tcpdump debug log output"
            default y
    endif

endif
```

## sysdrv/source/mcu/rt-thread/third_party/wice/Kconfig
```kconfig
config RT_USING_WLAN_WICED
    bool "enable wice wlan"
    select RT_USING_SDIO
    select RT_USING_SDIO0
    select RT_USING_LWIP
    select RT_USING_WIFI
    default n

if RT_USING_WLAN_WICED
config RT_USING_WICE_MFG_TEST
    bool "enable wice mfg test"
    default n

choice
    prompt "WICE Chip Selection"
    default RT_USING_WLAN_CHIP_AP6212_A

    config RT_USING_WLAN_CHIP_AP6181
        bool "AP6181"

    config RT_USING_WLAN_CHIP_AP6234
        bool "AP6234"

    config RT_USING_WLAN_CHIP_AP6255
        bool "AP6255"

    config RT_USING_WLAN_CHIP_AP6212
         bool "AP6212"

    config RT_USING_WLAN_CHIP_AP6212_A
         bool "AP6212_A"
endchoice
endif
```

## sysdrv/source/uboot/u-boot/arch/arm/mach-rockchip/px30/Kconfig
```kconfig
if ROCKCHIP_PX30

config TARGET_EVB_PX30
	bool "EVB_PX30"
	select BOARD_LATE_INIT

config SYS_SOC
	default "rockchip"

config SYS_MALLOC_F_LEN
	default 0x400

config SPL_SERIAL_SUPPORT
	default y

source "board/rockchip/evb_px30/Kconfig"

endif
```

## sysdrv/source/uboot/u-boot/arch/arm/mach-rockchip/rk1808/Kconfig
```kconfig
if ROCKCHIP_RK1808

config TARGET_EVB_RK1808
	bool "EVB_RK1808"
	select BOARD_LATE_INIT

config SYS_SOC
	default "rockchip"

config SYS_MALLOC_F_LEN
	default 0x400

source "board/rockchip/evb_rk1808/Kconfig"

endif
```

## sysdrv/source/uboot/u-boot/arch/arm/mach-rockchip/rk3066/Kconfig
```kconfig
if ROCKCHIP_RK3066

config TARGET_MK808_RK3066
        bool "MK808_RK3066"
	help
	  MK808 is a tv stick with usb host and otg, microsd card slot, hdmi and wifi.

config SYS_SOC
        default "rockchip"

config SYS_MALLOC_F_LEN
        default 0x0800

config SPL_LIBCOMMON_SUPPORT
        default y

config SPL_LIBGENERIC_SUPPORT
        default y

config SPL_SERIAL_SUPPORT
        default y

config TPL_LIBCOMMON_SUPPORT
        default y

config TPL_LIBGENERIC_SUPPORT
        default y

source "board/rikomagic/mk808_rk3066/Kconfig"

endif
```

## sysdrv/source/uboot/u-boot/arch/arm/mach-rockchip/rk322x/Kconfig
```kconfig
if ROCKCHIP_RK322X

config TARGET_EVB_RK3229
	bool "EVB_RK3229"
	select BOARD_LATE_INIT

config TARGET_GVA_RK3229
	bool "GVA RK3229 board"
	select BOARD_LATE_INIT
	help
	  GVA RK3229 is a SOM and base-board combination based on RK3229. It
	  target for Google Voice Assistant with Android Things project.

config SYS_SOC
	default "rockchip"

config SYS_MALLOC_F_LEN
	default 0x400

config SPL_SERIAL_SUPPORT
	default y

source "board/rockchip/evb_rk3229/Kconfig"
source "board/rockchip/gva_rk3229/Kconfig"

endif
```

## sysdrv/source/uboot/u-boot/arch/arm/mach-rockchip/rk3308/Kconfig
```kconfig
if ROCKCHIP_RK3308

config TARGET_EVB_RK3308
	bool "EVB_RK3308"
	select BOARD_LATE_INIT

config SYS_SOC
	default "rockchip"

config SYS_MALLOC_F_LEN
	default 0x400

config SPL_SERIAL_SUPPORT
	default y

source "board/rockchip/evb_rk3308/Kconfig"

endif
```

## sysdrv/source/uboot/u-boot/arch/arm/mach-rockchip/rk3528/Kconfig
```kconfig
if ROCKCHIP_RK3528

config TARGET_EVB_RK3528
	bool "EVB_RK3528"
	select BOARD_LATE_INIT
	help
	  RK3528 EVB is a evaluation board for Rockchp RK3528.

config SYS_SOC
	default "rockchip"

config SYS_MALLOC_F_LEN
	default 0x400

source board/rockchip/evb_rk3528/Kconfig

endif
```

## sysdrv/source/uboot/u-boot/arch/arm/mach-rockchip/rk3562/Kconfig
```kconfig
if ROCKCHIP_RK3562

config TARGET_EVB_RK3562
	bool "EVB_RK3562"
	select BOARD_LATE_INIT
	help
	  RK3562 EVB is a evaluation board for Rockchp RK3562.

config SYS_SOC
	default "rockchip"

config SYS_MALLOC_F_LEN
	default 0x400

source board/rockchip/evb_rk3562/Kconfig

endif
```

## sysdrv/source/uboot/u-boot/arch/arm/mach-rockchip/rk3576/Kconfig
```kconfig
if ROCKCHIP_RK3576

config TARGET_EVB_RK3576
	bool "EVB_RK3576"
	select BOARD_LATE_INIT
	help
	  RK3576 EVB is a evaluation board for Rockchp RK3576.

config SYS_SOC
	default "rockchip"

config SYS_MALLOC_F_LEN
	default 0x400

source board/rockchip/evb_rk3576/Kconfig

endif
```

## sysdrv/source/uboot/u-boot/arch/arm/mach-rockchip/rv1106/Kconfig
```kconfig
if ROCKCHIP_RV1106

config TARGET_EVB_RV1106
	bool "EVB_RV1106"
	help
	  RV1106 EVB is a evaluation board for Rockchp RV1106.

config SYS_SOC
	default "rockchip"

config SYS_MALLOC_F_LEN
	default 0x400

source board/rockchip/evb_rv1106/Kconfig

endif
```

## sysdrv/source/uboot/u-boot/board/rikomagic/mk808_rk3066/Kconfig
```kconfig
if TARGET_MK808_RK3066

config SYS_BOARD
	default "mk808_rk3066"

config SYS_VENDOR
	default "rikomagic"

config SYS_CONFIG_NAME
	default "mk808_rk3066"

config BOARD_SPECIFIC_OPTIONS # dummy
	def_bool y

endif
```

## sysdrv/source/uboot/u-boot/board/rockchip/evb_rk3288_rk1608/Kconfig
```kconfig
if TARGET_EVB_RK3288_RK1608

config SYS_BOARD
	default "evb_rk3288_rk1608"

config SYS_VENDOR
	default "rockchip"

config SYS_CONFIG_NAME
	default "evb_rk3288_rk1608"

config BOARD_SPECIFIC_OPTIONS # dummy
	def_bool y

endif
```

## sysdrv/source/uboot/u-boot/board/rockchip/evb_rk3562/Kconfig
```kconfig
if TARGET_EVB_RK3562

config SYS_BOARD
	default "evb_rk3562"

config SYS_VENDOR
	default "rockchip"

config SYS_CONFIG_NAME
	default "evb_rk3562"

config BOARD_SPECIFIC_OPTIONS # dummy
	def_bool y

endif
```

## sysdrv/source/uboot/u-boot/board/rockchip/evb_rv1106/Kconfig
```kconfig
if TARGET_EVB_RV1106

config SYS_BOARD
	default "evb_rv1106"

config SYS_VENDOR
	default "rockchip"

config SYS_CONFIG_NAME
	default "evb_rv1106"

config BOARD_SPECIFIC_OPTIONS # dummy
	def_bool y

endif
```

## sysdrv/source/uboot/u-boot/cmd/ddr_tool/Kconfig
```kconfig
menu "DDR Tool"

config CMD_DDR_TOOL
	bool "Enable DDR Tool"
	help
	  This enable ddr tool such as ddr dq eye, ddr test tool, memtester and stressapptest.

config CMD_DDR_DQ_EYE
	bool "Enable DDR DQ eye fuction"
	depends on CMD_DDR_TOOL
	help
	  This enable ddr dq eye fuction.

config CMD_DDR_TEST
	bool "Enable ddr test tool"
	depends on CMD_DDR_TOOL
	help
	  This enable ddr test tool code.

config CMD_MEMTESTER
	bool "Enable memtester for ddr"
	depends on CMD_DDR_TOOL
	help
	  This enables memtester for ddr.

config CMD_STRESSAPPTEST
	bool "Enable stressapptest for ddr"
	depends on CMD_DDR_TOOL
	help
	  This enables stressapptest for ddr.

endmenu
```

## sysdrv/source/uboot/u-boot/configs/evb-aarch32-rk3308_defconfig
```kconfig
CONFIG_ARM=y
CONFIG_ARCH_ROCKCHIP=y
CONFIG_SYS_MALLOC_F_LEN=0x4000
CONFIG_ROCKCHIP_RK3308=y
CONFIG_ARM64_BOOT_AARCH32=y
CONFIG_ROCKCHIP_SPL_RESERVE_IRAM=0x0
CONFIG_ROCKCHIP_VENDOR_PARTITION=y
# CONFIG_USING_KERNEL_DTB is not set
CONFIG_TRUST_INI="RK3308AARCH32TRUST.ini"
CONFIG_UBOOT_SIZE_KB=512
CONFIG_UBOOT_NUM=2
CONFIG_TRUST_SIZE_KB=512
CONFIG_TRUST_RSA_MODE=3
CONFIG_TARGET_EVB_RK3308=y
CONFIG_DEFAULT_DEVICE_TREE="rk3308-evb"
CONFIG_DEBUG_UART=y
# CONFIG_DISTRO_DEFAULTS is not set
CONFIG_ANDROID_BOOT_IMAGE=y
CONFIG_FIT=y
CONFIG_FIT_VERBOSE=y
# CONFIG_PASS_DEVICE_SERIAL_BY_FDT is not set
CONFIG_BOOTDELAY=0
CONFIG_SYS_CONSOLE_INFO_QUIET=y
# CONFIG_DISPLAY_CPUINFO is not set
CONFIG_ANDROID_BOOTLOADER=y
CONFIG_HUSH_PARSER=y
# CONFIG_FASTBOOT is not set
# CONFIG_CMD_BDI is not set
CONFIG_CMD_BOOTZ=y
# CONFIG_CMD_ELF is not set
# CONFIG_CMD_IMI is not set
# CONFIG_CMD_IMLS is not set
# CONFIG_CMD_XIMG is not set
# CONFIG_CMD_FLASH is not set
# CONFIG_CMD_FPGA is not set
CONFIG_CMD_GPT=y
# CONFIG_CMD_LOADB is not set
# CONFIG_CMD_LOADS is not set
CONFIG_CMD_BOOT_ANDROID=y
CONFIG_CMD_BOOT_ROCKCHIP=y
CONFIG_CMD_MMC=y
CONFIG_CMD_PART=y
CONFIG_CMD_USB=y
CONFIG_CMD_USB_MASS_STORAGE=y
# CONFIG_CMD_ITEST is not set
# CONFIG_CMD_SETEXPR is not set
CONFIG_CMD_DHCP=y
CONFIG_CMD_PXE=y
CONFIG_CMD_MII=y
CONFIG_CMD_PING=y
# CONFIG_CMD_MISC is not set
CONFIG_CMD_FAT=y
CONFIG_CMD_FS_GENERIC=y
# CONFIG_DOS_PARTITION is not set
CONFIG_EFI_PARTITION_ENTRIES_NUMBERS=64
CONFIG_OF_LIVE=y
CONFIG_OF_SPL_REMOVE_PROPS="pinctrl-0 pinctrl-names clock-names interrupt-parent assigned-clocks assigned-clock-rates assigned-clock-parents"
CONFIG_REGMAP=y
CONFIG_SYSCON=y
CONFIG_CLK=y
CONFIG_ROCKCHIP_GPIO=y
CONFIG_SYS_I2C_ROCKCHIP=y
CONFIG_DM_KEY=y
CONFIG_ADC_KEY=y
CONFIG_MMC_DW=y
CONFIG_MMC_DW_ROCKCHIP=y
CONFIG_DM_ETH=y
CONFIG_ETH_DESIGNWARE=y
CONFIG_GMAC_ROCKCHIP=y
CONFIG_PHY=y
CONFIG_PHY_ROCKCHIP_INNO_USB2=y
CONFIG_PINCTRL=y
CONFIG_DM_FUEL_GAUGE=y
CONFIG_REGULATOR_PWM=y
CONFIG_DM_REGULATOR_FIXED=y
CONFIG_PWM_ROCKCHIP=y
CONFIG_RAM=y
CONFIG_DM_RESET=y
CONFIG_RKFLASH=y
CONFIG_RKNANDC_NAND=y
CONFIG_RKSFC_NAND=y
CONFIG_RKSFC_NOR=y
CONFIG_BAUDRATE=1500000
CONFIG_DEBUG_UART_BASE=0xFF0C0000
CONFIG_DEBUG_UART_CLOCK=24000000
CONFIG_DEBUG_UART_SHIFT=2
CONFIG_DEBUG_UART_SKIP_INIT=y
CONFIG_SYSRESET=y
CONFIG_USB=y
CONFIG_USB_EHCI_HCD=y
CONFIG_USB_EHCI_GENERIC=y
CONFIG_USB_DWC2=y
CONFIG_USB_STORAGE=y
CONFIG_USB_GADGET=y
CONFIG_USB_GADGET_MANUFACTURER="Rockchip"
CONFIG_USB_GADGET_VENDOR_NUM=0x2207
CONFIG_USB_GADGET_PRODUCT_NUM=0x330d
CONFIG_USB_GADGET_DWC2_OTG=y
CONFIG_USB_GADGET_DOWNLOAD=y
# CONFIG_FAT_WRITE is not set
CONFIG_USE_TINY_PRINTF=y
CONFIG_SPL_TINY_MEMSET=y
CONFIG_ERRNO_STR=y
# CONFIG_EFI_LOADER is not set
```

## sysdrv/source/uboot/u-boot/configs/evb-px3se_defconfig
```kconfig
CONFIG_ARM=y
CONFIG_ARCH_ROCKCHIP=y
CONFIG_SYS_MALLOC_F_LEN=0x1000
CONFIG_ROCKCHIP_RK3128=y
CONFIG_ROCKCHIP_PX3SE=y
CONFIG_CHIP_NAME="PX3SE"
CONFIG_DEFAULT_DEVICE_TREE="px3se-evb"
CONFIG_DEBUG_UART=y
CONFIG_ANDROID_BOOT_IMAGE=y
CONFIG_FIT=y
# CONFIG_DISPLAY_CPUINFO is not set
CONFIG_ANDROID_BOOTLOADER=y
# CONFIG_FASTBOOT is not set
# CONFIG_CMD_IMLS is not set
CONFIG_CMD_GPT=y
CONFIG_CMD_LOAD_ANDROID=y
CONFIG_CMD_BOOT_ANDROID=y
CONFIG_CMD_BOOT_ROCKCHIP=y
CONFIG_CMD_MMC=y
CONFIG_CMD_USB=y
CONFIG_CMD_USB_MASS_STORAGE=y
# CONFIG_CMD_SETEXPR is not set
CONFIG_CMD_TIME=y
CONFIG_RKPARM_PARTITION=y
CONFIG_REGMAP=y
CONFIG_SYSCON=y
CONFIG_CLK=y
CONFIG_ROCKCHIP_GPIO=y
CONFIG_SYS_I2C_ROCKCHIP=y
CONFIG_DM_KEY=y
CONFIG_ADC_KEY=y
CONFIG_MMC_DW=y
CONFIG_MMC_DW_ROCKCHIP=y
CONFIG_PHY=y
CONFIG_PHY_ROCKCHIP_INNO_USB2=y
CONFIG_PINCTRL=y
CONFIG_REGULATOR_PWM=y
CONFIG_DM_REGULATOR_FIXED=y
CONFIG_RAM=y
CONFIG_DM_RESET=y
CONFIG_DEBUG_UART_BASE=0x20064000
CONFIG_DEBUG_UART_CLOCK=24000000
CONFIG_DEBUG_UART_SHIFT=2
CONFIG_SYSRESET=y
CONFIG_USB=y
CONFIG_USB_EHCI_HCD=y
CONFIG_USB_EHCI_GENERIC=y
CONFIG_USB_OHCI_HCD=y
CONFIG_USB_OHCI_GENERIC=y
CONFIG_USB_DWC2=y
CONFIG_USB_STORAGE=y
CONFIG_USB_GADGET=y
CONFIG_USB_GADGET_MANUFACTURER="Rockchip"
CONFIG_USB_GADGET_VENDOR_NUM=0x2207
CONFIG_USB_GADGET_PRODUCT_NUM=0x310c
CONFIG_USB_GADGET_DWC2_OTG=y
CONFIG_USB_GADGET_DOWNLOAD=y
CONFIG_USE_TINY_PRINTF=y
CONFIG_ERRNO_STR=y
```

## sysdrv/source/uboot/u-boot/configs/evb-rk3066_defconfig
```kconfig
CONFIG_ARM=y
CONFIG_ARCH_ROCKCHIP=y
CONFIG_ROCKCHIP_RK3066=y
CONFIG_TARGET_MK808_RK3066=y
CONFIG_DEFAULT_DEVICE_TREE="rk3066a-evb"
CONFIG_CMD_REGULATOR=y
CONFIG_CLK=y
CONFIG_REGMAP=y
CONFIG_SYSCON=y
CONFIG_RAM=y
CONFIG_SYS_MALLOC_F_LEN=0x2000
CONFIG_USE_PRIVATE_LIBGCC=y
CONFIG_CMD_DHRYSTONE=y
CONFIG_ERRNO_STR=y
CONFIG_SYS_NS16550=y
CONFIG_ENABLE_ARM_SOC_BOOT0_HOOK=y
CONFIG_BOOTDELAY=1
CONFIG_CONSOLE_MUX=y
CONFIG_DISPLAY_BOARDINFO=y
# CONFIG_DISPLAY_CPUINFO is not set
CONFIG_CMD_BOOTZ=y
CONFIG_DM_REGULATOR_FIXED=y
CONFIG_CMD_EXT4=y
CONFIG_CMD_FS_GENERIC=y
CONFIG_CMD_CACHE=y
CONFIG_DM_REGULATOR_GPIO=y
CONFIG_SYSRESET=y
CONFIG_CMD_MMC=y
CONFIG_MMC_DW=y
CONFIG_MMC_DW_ROCKCHIP=y
CONFIG_DM_MMC=y
CONFIG_CMD_GPT=y
# CONFIG_CMD_IMLS is not set
# CONFIG_CMD_SETEXPR is not set
CONFIG_EFI_PARTITION is not set
CONFIG_CMD_BOOTEFI is not set
CONFIG_CMD_BOOTEFI_HELLO_COMPILE is not set
CONFIG_EFI_LOADER is not set
CONFIG_CMD_GPIO=y
CONFIG_ROCKCHIP_GPIO=y
CONFIG_PINCTRL=y
CONFIG_PINCTRL_GENERIC=y
CONFIG_DEBUG_UART=y
CONFIG_DEBUG_UART_BASE=0x20064000
CONFIG_DEBUG_UART_CLOCK=24000000
CONFIG_DEBUG_UART_SHIFT=2
CONFIG_USB=y
CONFIG_DM_USB=y
CONFIG_USB_STORAGE=y
CONFIG_CMD_USB=y
CONFIG_USB_DWC2=y
CONFIG_USB_GADGET=y
CONFIG_USB_GADGET_DUALSPEED=y
CONFIG_USB_GADGET_DWC2_OTG=y
CONFIG_USB_GADGET_DWC2_OTG_PHY=y
CONFIG_USB_GADGET_VBUS_DRAW=500 
CONFIG_CMD_USB_MASS_STORAGE=y
CONFIG_USB_GADGET_DOWNLOAD=y
CONFIG_USB_GADGET_MANUFACTURER="Rockchip"
CONFIG_USB_GADGET_VENDOR_NUM=0x2207
CONFIG_USB_GADGET_PRODUCT_NUM=0x300a
CONFIG_BOARD_LATE_INIT=y
CONFIG_MTD_DEVICE=y
CONFIG_NAND_ROCKCHIP=y
CONFIG_CMD_MTDPARTS=y
CONFIG_MTD_PARTITIONS=y
CONFIG_NAND=y
CONFIG_USB_FUNCTION_DFU=y
CONFIG_DFU_RAM=y
CONFIG_CMD_DFU=y
CONFIG_SPL_BLK=y
CONFIG_SPL_CLK=y
CONFIG_SPL_DFU_RAM=y
CONFIG_SPL_DFU=y
CONFIG_SPL_DRIVERS_MISC_SUPPORT=y
CONFIG_SPL_ENV_SUPPORT=y
CONFIG_SPL_OF_CONTROL=y
CONFIG_SPL_PINCTRL=y
CONFIG_SPL_RAM=y
CONFIG_SPL_RAM_SUPPORT=y
CONFIG_SPL_REGMAP=y
CONFIG_SPL_STACK_R=y
CONFIG_SPL_STACK_R_ADDR=0x70000000
CONFIG_SPL_STACK_R_MALLOC_SIMPLE_LEN=0x200000
CONFIG_SPL_SYSCON=y
CONFIG_SPL_TINY_MEMSET=y
CONFIG_SPL_USB_GADGET=y
CONFIG_OF_SPL_REMOVE_PROPS="pinctrl-0 pinctrl-names clock-names interrupt-parent assigned-clocks assigned-clock-rates assigned-clock-parents"
# CONFIG_SPL_USE_ARCH_MEMCPY is not set
# CONFIG_SPL_USE_ARCH_MEMSET is not set
# CONFIG_TPL_USE_ARCH_MEMCPY is not set
# CONFIG_TPL_USE_ARCH_MEMSET is not set
# CONFIG_SPL_SIMPLE_BUS is not set
# CONFIG_SPL_PINCTRL_FULL is not set
# CONFIG_SPL_EFI_PARTITION is not set
# CONFIG_SPL_BOARD_INIT is not set
# CONFIG_SPL_DOS_PARTITION is not set
# CONFIG_SPL_EXT_SUPPORT is not set
# CONFIG_SPL_LIBDISK_SUPPORT is not set
# CONFIG_SPL_MMC_SUPPORT is not set
CONFIG_TPL_BOOTROM_SUPPORT=y
CONFIG_TPL_CLK=y
CONFIG_TPL_DM=y
CONFIG_TPL_DM_SERIAL=y
# CONFIG_TPL_DRIVERS_MISC_SUPPORT is not set
CONFIG_TPL_OF_CONTROL=y
CONFIG_TPL_OF_PLATDATA=y
CONFIG_TPL_RAM=y
CONFIG_TPL_REGMAP=y
CONFIG_TPL_ROCKCHIP_BACK_TO_BROM=y
CONFIG_TPL_SERIAL_SUPPORT=y
CONFIG_TPL_SYSCON=y
CONFIG_TPL_TINY_MEMSET=y
```

## sysdrv/source/uboot/u-boot/configs/evb-rk3128_defconfig
```kconfig
CONFIG_ARM=y
CONFIG_ARCH_ROCKCHIP=y
CONFIG_SYS_MALLOC_F_LEN=0x1000
CONFIG_ROCKCHIP_RK3128=y
CONFIG_DEFAULT_DEVICE_TREE="rk3128-evb"
CONFIG_DEBUG_UART=y
CONFIG_FIT=y
# CONFIG_DISPLAY_CPUINFO is not set
CONFIG_ANDROID_BOOTLOADER=y
CONFIG_ANDROID_AVB=y
CONFIG_BOARD_EARLY_INIT_R=y
CONFIG_FASTBOOT_BUF_ADDR=0x60800800
CONFIG_FASTBOOT_BUF_SIZE=0x04000000
CONFIG_FASTBOOT_FLASH=y
CONFIG_FASTBOOT_FLASH_MMC_DEV=0
# CONFIG_CMD_IMLS is not set
CONFIG_CMD_GPT=y
CONFIG_CMD_BOOT_ANDROID=y
CONFIG_CMD_BOOT_ROCKCHIP=y
CONFIG_CMD_MMC=y
CONFIG_CMD_USB=y
CONFIG_CMD_USB_MASS_STORAGE=y
# CONFIG_CMD_SETEXPR is not set
CONFIG_CMD_TIME=y
CONFIG_REGMAP=y
CONFIG_SYSCON=y
CONFIG_CLK=y
CONFIG_ROCKCHIP_GPIO=y
CONFIG_SYS_I2C_ROCKCHIP=y
CONFIG_MMC_DW=y
CONFIG_MMC_DW_ROCKCHIP=y
CONFIG_PHY=y
CONFIG_PHY_ROCKCHIP_INNO_USB2=y
CONFIG_PINCTRL=y
CONFIG_DM_PMIC=y
CONFIG_PMIC_RK8XX=y
CONFIG_REGULATOR_PWM=y
CONFIG_DM_REGULATOR_FIXED=y
CONFIG_REGULATOR_RK8XX=y
CONFIG_RAM=y
CONFIG_DM_RESET=y
CONFIG_DEBUG_UART_BASE=0x20068000
CONFIG_DEBUG_UART_CLOCK=24000000
CONFIG_DEBUG_UART_SHIFT=2
CONFIG_SYSRESET=y
CONFIG_USB=y
CONFIG_USB_EHCI_HCD=y
CONFIG_USB_EHCI_GENERIC=y
CONFIG_USB_OHCI_HCD=y
CONFIG_USB_OHCI_GENERIC=y
CONFIG_USB_DWC2=y
CONFIG_USB_STORAGE=y
CONFIG_USB_GADGET=y
CONFIG_USB_GADGET_DWC2_OTG=y
CONFIG_USB_GADGET_DOWNLOAD=y
CONFIG_USB_GADGET_MANUFACTURER="Rockchip"
CONFIG_USB_GADGET_VENDOR_NUM=0x2207
CONFIG_USB_GADGET_PRODUCT_NUM=0x310c
CONFIG_USE_TINY_PRINTF=y
CONFIG_ERRNO_STR=y
# CONFIG_EFI_LOADER is not set
CONFIG_AVB_LIBAVB=y
CONFIG_AVB_LIBAVB_AB=y
CONFIG_AVB_LIBAVB_ATX=y
CONFIG_AVB_LIBAVB_USER=y
CONFIG_RK_AVB_LIBAVB_USER=y
CONFIG_OPTEE_CLIENT=y
CONFIG_OPTEE_V1=y
```

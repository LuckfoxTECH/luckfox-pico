## sysdrv/source/mcu/rt-thread/bsp/rockchip/common/hal/project/rk3568-mcu/Image/amp.its
```
/*
 * Copyright (C) 2023 Rockchip Electronics Co., Ltd
 *
 * SPDX-License-Identifier: GPL-2.0
 */

/dts-v1/;
/ {
	description = "Rockchip AMP FIT Image";
	#address-cells = <1>;

	images {
		mcu {
			description  = "mcu";
			data         = /incbin/("./mcu.bin");
			type         = "standalone";	// must be "standalone"
			compression  = "none";
			arch         = "arm";		// "arm64" or "arm", the same as U-Boot state
			load         = <0x08200000>;
			udelay       = <1000000>;
			hash {
				algo = "sha256";
			};
		};
	};

	configurations {
		default = "conf";
		conf {
			description = "Rockchip AMP images";
			rollback-index = <0x0>;
			loadables = "mcu";

			signature {
				algo = "sha256,rsa2048";
				padding = "pss";
				key-name-hint = "dev";
				sign-images = "loadables";
			};
		};
	};
};
```

## sysdrv/source/mcu/rt-thread/bsp/rockchip/common/hal/project/rk3568/Image/amp.its
```
/* SPDX-License-Identifier: BSD-3-Clause */
/*
 * Copyright (c) 2023 Rockchip Electronics Co., Ltd.
 */

/dts-v1/;
/ {
	description = "FIT source file for rockchip AMP";
	#address-cells = <1>;

	images {

		amp0 {
			description  = "bare-metal-core0";
			data         = /incbin/("hal0.bin");
			type         = "firmware";
			compression  = "none";
			arch         = "arm";	 // "arm64" or "arm"
			cpu          = <0x000>;  // mpidr
			thumb        = <0>;      // 0: arm or thumb2; 1: thumb
			hyp          = <0>;      // 0: el1/svc; 1: el2/hyp
			load         = <0x12000000>;
			udelay       = <10000>;
			hash {
				algo = "sha256";
			};
		};

		amp1 {
			description  = "bare-metal-core1";
			data         = /incbin/("hal1.bin");
			type         = "firmware";
			compression  = "none";
			arch         = "arm";
			cpu          = <0x100>;
			thumb        = <0>;
			hyp          = <0>;
			load         = <0x01800000>;
			udelay       = <10000>;
			hash {
				algo = "sha256";
			};
		};

		amp2 {
			description  = "bare-metal-core2";
			data         = /incbin/("hal2.bin");
			type         = "firmware";
			compression  = "none";
			arch         = "arm";
			cpu          = <0x200>;
			thumb        = <0>;
			hyp          = <0>;
			load         = <0x03800000>;
			udelay       = <10000>;
			hash {
				algo = "sha256";
			};
		};

		amp3 {
			description  = "bare-metal-core3";
			data         = /incbin/("hal3.bin");
			type         = "firmware";
			compression  = "none";
			arch         = "arm";
			cpu          = <0x300>;
			thumb        = <0>;
			hyp          = <0>;
			load         = <0x05800000>;
			udelay       = <10000>;
			hash {
				algo = "sha256";
			};
		};
	};

	configurations {
		default = "conf";
		conf {
			description = "Rockchip AMP images";
			rollback-index = <0x0>;
			loadables = "amp0", "amp1", "amp2", "amp3";

			signature {
				algo = "sha256,rsa2048";
				padding = "pss";
				key-name-hint = "dev";
				sign-images = "loadables";
			};
		};
	};
};
```

## sysdrv/source/mcu/rt-thread/bsp/rockchip/common/tests/Kconfig
```kconfig
menu "RT-Thread Common Test case"

config RT_USING_TC
    bool "Enable Kernel TEST"
    default n

config RT_USING_FILE_TEST
    bool "Enable File TEST"
    default n

config RT_USING_COMMON_TEST
    bool "Enable BSP Common TEST"
    default n

    if RT_USING_COMMON_TEST

    config RT_USING_AUTO_TEST
        bool "Enable BSP AUTO TEST"
        select RT_USING_COMMON_TEST_SNOR
        default n

    config RT_USING_COMMON_TEST_SUSPEND
        bool "Enable BSP Common Timer and GPIO Suspend/Resume TEST"
        default n
    config RT_USING_COMMON_TEST_AUDIO
        bool "Enable BSP Common AUDIO TEST"
        depends on RT_USING_AUDIO && RT_USING_LARGE_HEAP && RT_USING_UNCACHE_HEAP
        default n
    config RT_USING_COMMON_TEST_CODEC_ES8388
        bool "Enable BSP Common CODEC ES8388 TEST"
        depends on RT_USING_CODEC
        default n

    config RT_USING_COMMON_TEST_CPU_USAGE
        bool "Enable BSP Common RK PM CPU Usage TEST"
        default n

    config RT_USING_COMMON_TEST_DCACHE
        bool "Enable BSP Common Dcache TEST"
        default n

    config RT_USING_COMMON_TEST_ICACHE
        bool "Enable BSP Common Icache TEST"
        default n

    config RT_USING_COMMON_TEST_DISPLAY
        bool "Enable BSP Common DISPLAY TEST"
        depends on RT_USING_VOP
        default n

    config RT_USING_SPI_SCREEN_TEST
        bool "Enable BSP Common SPI Screen TEST"
        depends on RT_USING_SPI_SCREEN
        default n

    config RT_USING_COMMON_TEST_DSP
        bool "Enable BSP Common DSP TEST"
        depends on RT_USING_DSP
        default n

        if RT_USING_COMMON_TEST_DSP
        config RT_USING_DSP_WAKEUP
            bool "Enable Dsp wakeup function"
            default n
        endif

    config RT_USING_DSP_OPUS_CODEC_TEST
        bool "Enable BSP Common DSP opus Codec TEST"
        depends on RT_USING_DSP
        default n

    config RT_USING_COMMON_TEST_GPIO
        bool "Enable BSP Common GPIO TEST"
        depends on RT_USING_PIN
        default n

    config RT_USING_COMMON_TEST_I2C
        bool "Enable BSP Common I2C TEST"
        depends on RT_USING_I2C
        default n

    config RT_USING_COMMON_TEST_INTC
        bool "Enable BSP Common Interrupt Controller TEST"
        default n

    config RT_USING_COMMON_TEST_KEYCTRL
        bool "Enable BSP Common KEYCTRL TEST"
        depends on RT_USING_KEYCTRL
        default n

    config RT_USING_COMMON_TEST_MBOX
        bool "Enable BSP Common MBOX TEST"
        default n

    config RT_USING_COMMON_MEMTESTER
        bool "Enable BSP Common MEMTESTER"
        default n

    config RT_USING_COMMON_TEST_MPU
        bool "Enable BSP Common MPU TEST"
        default n

    config RT_USING_COMMON_TEST_PM
        bool "Enable BSP Common PM TEST"
        select RT_USING_CRU
        default n

    config RT_USING_COMMON_TEST_SNOR
        bool "Enable BSP Common SNOR TEST"
        select RT_USING_SNOR
        default n

    config RT_USING_COMMON_TEST_SPI
        bool "Enable BSP Common SPI TEST"
        depends on RT_USING_SPI
        default n

    config RT_USING_COMMON_TEST_SPI2APB
        bool "Enable BSP Common SPI2APB TEST"
        depends on RT_USING_SPI2APB
        default n

    config RT_USING_COMMON_STRESS_TEST
        bool "Enable BSP Common STRESS TEST"
        select RT_USING_RESET
        select RT_USING_BENCHMARK
        select RT_USING_COREMARK
        select RT_USING_COMMON_MEMTESTER
        default n

    config RT_USING_COMMON_TEST_UART
        bool "Enable BSP Common UART TEST"
        depends on RT_USING_UART && RT_USING_POSIX_TERMIOS && RT_USING_POSIX
        default n

    config RT_USING_COMMON_TEST_USAGE
        bool "Enable BSP Common USAGE TEST"
        depends on RT_USING_CPU_USAGE
        default n

    config RT_USING_COMMON_TEST_WDT
        bool "Enable BSP Common WDT TEST"
        depends on RT_USING_WDT
        default n

    config RT_USING_COMMON_TEST_PERFORMANCE
        bool "Enable BSP Common Performance TEST"

    config RT_USING_COMMON_TEST_VICAP
        bool "Enable BSP Common VICAP TEST"
        depends on RT_USING_VICAP && RT_USING_CAMERA
        default n
        if RT_USING_COMMON_TEST_VICAP
        config RT_USING_VICAP_TEST_DISPLAY
             bool "Enable display for vicap"
             select RT_USING_PANEL_ST7703_DS
             default n
        endif

    config RT_USING_COMMON_TEST_SWALLOW_RGB
        bool "Enable BSP Common SWALLOW RGB TEST"
        depends on RT_USING_MIPI_DPHY && RT_USING_CAMERA
        default n

    config RT_USING_COMMON_TEST_FWANALYSIS
        bool "Enable Firmware Analysis TEST"
        depends on RT_USING_FWANALYSIS
        default n

    config RT_USING_COMMON_TEST_OTA
        bool "Enable ota TEST"
        depends on RT_USING_OTA
        default n

    config RT_USING_COMMON_TEST_PSRAM
        bool "Enable BSP Common Psram TEST"
        depends on RT_USING_QPIPSRAM
        default n

    config RT_USING_COMMON_TEST_SPINAND
        bool "Enable BSP Common SPI Nand TEST"
        depends on RT_USING_SPINAND
        default n

    config RT_USING_COMMON_TEST_TIMER
        bool "Enable BSP Common TIMER TEST"
        default n

    config RT_USING_COMMON_TEST_LINUX_RPMSG_LITE
        bool "Enable linux rpmsg lite test"
        default n

    config RT_USING_COMMON_TEST_RPMSG_LITE
        bool "Enable rpmsg lite test"
        depends on RT_USING_RPMSG_LITE
        default n

    config RT_USING_COMMON_TEST_IPC
        bool "Enable shmem ipc test"
        default n

    config RT_USING_COMMON_TEST_AMPMSG
        bool "Enable shmem ampmsg test"
        default n

    config RT_USING_COMMON_TEST_PCIE_DMA
        bool "Enable BSP Common PCIE DMA TEST"
        default n
    endif

endmenu
```

## sysdrv/source/mcu/rt-thread/bsp/rockchip/rv1106-mcu/Kconfig
```kconfig
mainmenu "RT-Thread Configuration"

config BSP_DIR
    string
    option env="BSP_ROOT"
    default "."

config RTT_DIR
    string
    option env="RTT_ROOT"
    default "../../.."

config PKGS_DIR
    string
    option env="PKGS_ROOT"
    default "packages"

config SOC_RV1106
    bool

config BOARD_RV1106_RISCV_EVB
    bool
    select ARCH_RISCV
    select SOC_RV1106
    default y

source "$RTT_DIR/Kconfig"
source "$BSP_DIR/board/Kconfig"
source "$BSP_DIR/drivers/Kconfig"
source "$BSP_DIR/../common/tests/Kconfig"
source "$RTT_DIR/applications/Kconfig"
```

## sysdrv/source/mcu/rt-thread/bsp/rockchip/rv1106-mcu/board/Kconfig
```kconfig
menu "RT-Thread board config"

config RT_BOARD_NAME
    string "the board name of you use"
    default "rv1106_evb-SC3338-ADC"

config RT_USING_CAM_STREAM_ON_LATE
    bool "cam stream on delay after ae init"
    default y

source "$BSP_DIR/board/$RT_BOARD_NAME/Kconfig"

endmenu
```

## sysdrv/source/mcu/rt-thread/bsp/rockchip/rv1106-mcu/drivers/Kconfig
```kconfig
source "$BSP_DIR/../common/drivers/Kconfig"

menu "RT-Thread rockchip rv1106 drivers"

config RT_USING_CRU
    bool "Enable CRU"
    default n

if RT_USING_I2C
menu "Enable I2C"
    config RT_USING_I2C0
        bool "Enable I2C0"
        default n

    config RT_USING_I2C1
        bool "Enable I2C1"
        default n

    config RT_USING_I2C2
        bool "Enable I2C2"
        default n

    config RT_USING_I2C3
        bool "Enable I2C3"
        default n

    config RT_USING_I2C4
        bool "Enable I2C4"
        default n

    config RT_USING_I2C5
        bool "Enable I2C5"
        default n
endmenu
endif

if RT_USING_PWM
    config RT_USING_PWM0
        bool "Enable PWM0"
        default n

    config RT_USING_PWM1
        bool "Enable PWM1"
        default n

    config RT_USING_PWM2
        bool "Enable PWM2"
        default n
endif

config RT_USING_SARADC
    bool "Enable SARADC"
    default n

menu "Enable UART"
    config RT_USING_UART
        bool "Enable UART"
        default y

    if RT_USING_UART
    config RT_USING_UART0
        bool "Enable UART0"
        default n

    config RT_USING_UART2
        bool "Enable UART2"
        default y
    endif
endmenu

endmenu
```

## sysdrv/source/mcu/rt-thread/components/aupipe/Kconfig
```kconfig
menuconfig RT_USING_AUPIPE
    bool "Enable Audio Pipeline for rt-thread"
    default n

if RT_USING_AUPIPE

    menu "Audio Pipeline Plug-in Select"

        config RT_USING_AUPIPE_AUDIOSRC
            bool "Enable audiosrc"
            depends on RT_USING_AUPIPE
            default n

        config RT_USING_AUPIPE_AUDIOSINK
            bool "Enable audiosink"
            depends on RT_USING_AUPIPE
            default n

        config RT_USING_AUPIPE_QUEUE
            bool "Enable queue"
            depends on RT_USING_AUPIPE
            default n

        config RT_USING_AUPIPE_AUDIOROUTE
            bool "Enable audioroute"
            depends on RT_USING_AUPIPE
            default n

        config RT_USING_AUPIPE_AUDIOTEE
            bool "Enable audiotee"
            depends on RT_USING_AUPIPE
            default n

        config RT_USING_AUPIPE_FILESRC
            bool "Enable filesrc"
            depends on RT_USING_AUPIPE
            default n

        config RT_USING_AUPIPE_FILESINK
            bool "Enable filesink"
            depends on RT_USING_AUPIPE
            default n

        config RT_USING_AUPIPE_ECNR
            bool "Enable ECNR"
            depends on RT_USING_AUPIPE
            depends on RT_USING_RPMSG_LITE
            default n

    endmenu

endif
```

## sysdrv/source/mcu/rt-thread/components/benchmark/Kconfig
```kconfig
menu "RT-Thread Benchmarks"

config RT_USING_BENCHMARK
    bool "Enable benchmarks for rt-thread"
    default n

config RT_USING_TINYMEMBENCH
    bool "Enable tinymembench"
	depends on RT_USING_BENCHMARK
    default n

config RT_USING_COREMARK
    bool "Enable coremark"
    depends on RT_USING_BENCHMARK
    default n

config RT_USING_DHRYSTONE
    bool "Enable dhrystone"
    depends on RT_USING_BENCHMARK
    default n

config RT_USING_FHOURSTONE
    bool "Enable fhourstone"
    depends on RT_USING_BENCHMARK
    default n

config RT_USING_LINPACK
    bool "Enable linpack"
    depends on RT_USING_BENCHMARK
    default n

config RT_USING_PI_CSS5
    bool "Enable pi_css5"
    depends on RT_USING_BENCHMARK
    default n

config RT_USING_WHETSTONE
    bool "Enable whetstone"
    depends on RT_USING_BENCHMARK
    default n

endmenu
```

## sysdrv/source/mcu/rt-thread/components/dfs/filesystems/littlefs/Kconfig
```kconfig
# Kconfig file for package littlefs
menuconfig RT_USING_LITTLEFS
    bool "Littlefs: A high-integrity embedded file system"
    default n

if RT_USING_LITTLEFS

    config LFS_READ_SIZE
        int "disk read size"
        default 256

    config LFS_PROG_SIZE
        int "disk write size"
        default 256

    config LFS_BLOCK_SIZE
        int "disk block size"
        default 4096

    config LFS_LOOKAHEAD
        int "lfs lookahead size"
        default 512

endif
```

## sysdrv/source/mcu/rt-thread/components/http/Kconfig
```kconfig
config RT_USING_NET_HTTP
    bool "Enable http"
    default n
    help
        Select this option to enable HTTP
```

## sysdrv/source/mcu/rt-thread/components/ota/Kconfig
```kconfig
menuconfig RT_USING_OTA
    bool
    prompt "Enable Ota upgrade"
    default n
    select RT_USING_RESET
    select RT_USING_FWANALYSIS
    help
        Select this option to enable firmware ota upgrade

if RT_USING_OTA

    menu "OTA Component Options"
        config RT_USING_OTA_RECOVERY
            bool
            prompt "Enable ota upgrade in recovery mode"
            default n

        choice
            prompt "OTA upgrade from where"
            default RT_USING_OTA_FROM_LOCAL

            config RT_USING_OTA_FROM_LOCAL
                bool "local"
            config RT_USING_OTA_FROM_HTTP
                bool "http"

            config RT_OTA_HTTP_URL
                string "Url of firmware from http server" if RT_USING_OTA_FROM_HTTP

        endchoice
        config RT_SUPPORT_ROOT_AB
            bool
            depends on !RT_USING_OTA_RECOVERY
            prompt "Enable support root A/B partition"
            default n
    endmenu

endif
```

## sysdrv/source/mcu/rt-thread/components/rpmsg_cmd/Kconfig
```kconfig
menuconfig RT_USING_RPMSG_CMD
    bool "Enable RPMsg command for rt-thread"
    depends on RT_USING_RPMSG_LITE
    default n
```

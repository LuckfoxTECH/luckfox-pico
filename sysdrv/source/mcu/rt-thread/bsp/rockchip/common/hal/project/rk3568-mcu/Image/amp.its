## sysdrv/source/mcu/rt-thread/components/utilities/cmbacktrace/Kconfig
```kconfig
menuconfig RT_USING_CMBACKTRACE
    bool "CmBacktrace: Advanced fault backtrace library for ARM Cortex-M series MCU."
    default n

if RT_USING_CMBACKTRACE

    choice
        prompt "CPU Platform"
        default PKG_CMBACKTRACE_PLATFORM_NOT_SELECTED
        help
          Select the ARM Cortex-M CPU Platform of your device
        config PKG_CMBACKTRACE_PLATFORM_M0_M0PLUS
            bool "Cortex-M0/M0+"
        config PKG_CMBACKTRACE_PLATFORM_M3
            bool "Cortex-M3"
        config PKG_CMBACKTRACE_PLATFORM_M4
            bool "Cortex-M4"
        config PKG_CMBACKTRACE_PLATFORM_M7
            bool "Cortex-M7"
        config PKG_CMBACKTRACE_PLATFORM_NOT_SELECTED
            bool "Not selected, please select"
    endchoice

    config PKG_CMBACKTRACE_DUMP_STACK
        bool
        prompt "Dump the thread or main stack info"
        default y
        help
          Dump the stack information when a fault occurs. It will add a lot of print information.

    choice
        prompt "Language of print information"
        default PKG_CMBACKTRACE_PRINT_ENGLISH
        help
          Select the language of print information when a fault occurs
        config PKG_CMBACKTRACE_PRINT_ENGLISH
            bool "Engish"
        config PKG_CMBACKTRACE_PRINT_CHINESE
            bool "Chinese"
    endchoice

    config PKG_CMBACKTRACE_FAULT_REBOOT
        bool "force reboot after a fault occur"
        default n
        depends on RT_USING_RESET

    config PKG_CMBACKTRACE_FAULT_DUMP_TO_FLASH
        bool
        prompt "Dump the fault to flash"
        default n
        help
          Dump the fault information to flash, you need a breakpad partition.

    if PKG_CMBACKTRACE_FAULT_DUMP_TO_FLASH

        config PKG_CMBACKTRACE_FLASH_PARTITION_NAME
            string "the name of partition which you want store fault information."
            default "breakpad"

        config PKG_CMBACKTRACE_DUMP_BUF_SIZE
            int "the buffer size for dump fault information to flash."
            default 4096

    endif

endif
```

## sysdrv/source/mcu/rt-thread/examples/bluetooth/Kconfig
```kconfig
menu "Bluetooth examlpes"

source "$RTT_DIR/examples/bluetooth/bt_api_test/Kconfig"
source "$RTT_DIR/examples/bluetooth/bt_discovery/Kconfig"
source "$RTT_DIR/examples/bluetooth/a2dp_sink/Kconfig"
source "$RTT_DIR/examples/bluetooth/a2dp_source/Kconfig"
source "$RTT_DIR/examples/bluetooth/hfp_client/Kconfig"

endmenu
```

## sysdrv/source/mcu/rt-thread/examples/bluetooth/a2dp_sink/Kconfig
```kconfig
menu "Example 'A2DP SINK' Config"

    config A2DP_SINK_EXAMPLE
        bool "Demo of a2dp audio sink role"
        default n
        help
            This example involves the use of Bluetooth legacy profile A2DP for audio stream reception,
            AVRCP for media information notifications, and I2S for audio stream output interface.

endmenu
```

## sysdrv/source/mcu/rt-thread/examples/bluetooth/a2dp_source/Kconfig
```kconfig
menu "Example 'A2DP SOURCE' Config "

    config A2DP_SOURCE_EXAMPLE
        bool "Demo of a2dp audio source role
    default n
        help
            This example is able to run on any commonly available Koala development board.
            And is supposed to connect to A2DP sink example in RT-thread.

endmenu
```

## sysdrv/source/mcu/rt-thread/examples/bluetooth/bt_api_test/Kconfig
```kconfig
menu "Example 'BT API TEST' Config"

    config BT_API_TEST
        bool "BlueDroid API test for app"
        default n
endmenu
```

## sysdrv/source/mcu/rt-thread/examples/bluetooth/bt_discovery/Kconfig
```kconfig
menu "Example 'BT DISCOVERY' Config"

    config BT_DISCOVERY_EXAMPLES
        bool "init bluetooth or open scan mode"
        default n
endmenu
```

## sysdrv/source/mcu/rt-thread/examples/bluetooth/hfp_client/Kconfig
```kconfig
menu "Example 'HFP CLIENT' Config"

    config HFP_CLIENT_EXAMPLE
        bool "Demo of hfp client"
    default n

endmenu
```

## sysdrv/source/mcu/rt-thread/examples/bluetooth/hfp_client/sdkconfig.defaults
```kconfig
# Override some defaults so BT stack is enabled and
# Classic BT is enabled and BT_DRAM_RELEASE is disabled
CONFIG_BT_ENABLED=y
CONFIG_BTDM_CONTROLLER_MODE_BLE_ONLY=
CONFIG_BTDM_CONTROLLER_MODE_BR_EDR_ONLY=y
CONFIG_BTDM_CONTROLLER_MODE_BTDM=
CONFIG_BLUEDROID_ENABLED=y
CONFIG_CLASSIC_BT_ENABLED=y
CONFIG_A2DP_ENABLE=y
CONFIG_BT_SPP_ENABLED=n
CONFIG_GATTS_ENABLE=n
CONFIG_GATTC_ENABLE=n
CONFIG_BLE_SMP_ENABLE=n
CONFIG_HFP_ENABLE=y
CONFIG_HFP_CLIENT_ENABLE=y
CONFIG_HFP_AUDIO_DATA_PATH_HCI=y
CONFIG_HFP_CLIENT_EXAMPLE=y
```

## sysdrv/source/mcu/rt-thread/third_party/Kconfig
```kconfig
menu "RT-Thread third party package"

source "$RTT_DIR/third_party/cmsis/Kconfig"
source "$RTT_DIR/third_party/wice/Kconfig"
source "$RTT_DIR/third_party/netutils/Kconfig"
source "$RTT_DIR/third_party/bt/Kconfig"
source "$RTT_DIR/third_party/cypress/Kconfig"
source "$RTT_DIR/third_party/audio/audio_server/Kconfig"
endmenu
```

## sysdrv/source/mcu/rt-thread/third_party/audio/audio_server/Kconfig
```kconfig
menuconfig RT_USING_AUDIO_SERVER
    bool "Audio server"
    select RT_USING_UNCACHE_HEAP
    default n

if RT_USING_AUDIO_SERVER
    choice
        prompt "Compile type"
        default AUDIO_USING_STATIC_LIBRARY
        help
          Choice the complie way, link the static
          library or compile with source code

        config AUDIO_USING_STATIC_LIBRARY
            bool "Use static library"

        config AUDIO_USING_SOURCE_CODE
            bool "Use source code"
    endchoice

    if AUDIO_USING_SOURCE_CODE

        config AUDIO_ENABLE_PLAYER
            bool "Enable player"
            default n
            select AUDIO_ENABLE_PLUGINS
            select AUDIO_PLUGIN_RESAMPLE

        config AUDIO_ENABLE_RECORDER
            bool "Enable recorder"
            default n

        menuconfig AUDIO_ENABLE_ENDECODE
            bool "Enable encode and decode"
            default n

        if AUDIO_ENABLE_ENDECODE

            choice
                prompt "Codec run on"
                default AUDIO_CODEC_RUN_ON_CM4
                help
                  Choice codec run on dsp or cm4

                config AUDIO_CODEC_RUN_ON_DSP
                    bool "DSP"

                config AUDIO_CODEC_RUN_ON_CM4
                    bool "CM4"
            endchoice

            config AUDIO_DECODER_MP3
                bool "Enable mp3 decode"
                default n

            config AUDIO_DECODER_APE
                bool "Enable ape decode"
                default n

            config AUDIO_DECODER_AMR
                bool "Enable amr decode"
                default n

            config AUDIO_ENCODER_AMR
                bool "Enable amr encode"
                default n

            config AUDIO_ENCODER_SPEEX
                bool "Enable speex encode"
                default n

        endif

        menuconfig AUDIO_ENABLE_PLUGINS
            bool "Enable audio plugins"
            default n

        if AUDIO_ENABLE_PLUGINS

            config AUDIO_PLUGIN_RESAMPLE
                bool "Enable resample plugin"
                default n

        endif

    endif

    source "$RTT_DIR/third_party/audio/audio_server/extcodec/Kconfig"

    config AUDIO_ENABLE_PLAYER_TEST
        bool "Enable player test"
        default n

    config AUDIO_ENABLE_RECORDER_TEST
        bool "Enable recorder test"
        default n

endif
```

## sysdrv/source/mcu/rt-thread/third_party/audio/audio_server/extcodec/Kconfig
```kconfig
menuconfig RT_USING_EXT_CODEC
    bool "Enable external encode and decode"
    default n

if RT_USING_EXT_CODEC

    config RT_USING_LIB_OPUS
        bool
        default n

    config RT_USING_LIB_OPUSENC
        bool
        default n

    config RT_USING_LIB_OGG
        bool
        default n

    config RT_USING_EXT_OPUS_DECODER
        bool "Enable external opus decode"
        select RT_USING_LIB_OPUS
        select RT_USING_LIB_OGG
        default n

    config RT_USING_EXT_OPUS_ENCODER
        bool "Enable external opus encode"
        select RT_USING_LIB_OPUS
        select RT_USING_LIB_OPUSENC
        default n

    config RT_USING_EXT_FLAC_DECODER
        bool "Enable external flac decode"
        default n

endif
```

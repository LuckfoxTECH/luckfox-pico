// SPDX-License-Identifier: (GPL-2.0+ OR MIT)
/*
 * Copyright (c) 2022 Rockchip Electronics Co., Ltd.
 */

#include "rv1106-thunder-boot.dtsi"

/ {
	thunder_boot_mmc: thunder-boot-mmc {
		compatible = "rockchip,thunder-boot-mmc";
		reg = <0xffaa0000 0x4000>;
		clocks = <&cru HCLK_SDMMC>, <&cru CCLK_SRC_SDMMC>;
		clock-names = "biu", "ciu";
		memory-region-src = <&ramdisk_c>;
		memory-region-dst = <&ramdisk_r>;
	};
};
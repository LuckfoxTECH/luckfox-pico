## sysdrv/drv_ko/wifi/atbm6441/Kconfig
```kconfig
menuconfig ATBM_WIRELESS
    tristate "Atbm Wireless Lan"
    default m

if ATBM_WIRELESS

if ATBM_MENUCONFIG
choice
	prompt "select chip-set"
	default ATBM6041
	help
	Here,you must make sure which chip-set you will want to use,601x
	602x 603x or 6041
config ATBM601x
    bool "ATBM_601x WLAN support"
    help
	ATBM601x chip-set
config ATBM602x
    bool "ATBM_602x WLAN support"
    help
	ATBM602x chip-set
config ATBM603x
    bool "ATBM_603x WLAN support"
    help
	ATBM603x chip-set
config ATBM6041
    bool "ATBM_6041 WLAN support"
    help
	ATBM6041 chip-set
endchoice

choice
    prompt "select which bus will be used"
    default ATBM_SDIO_BUS
    help
     Here,you must make sure what interface you will want to use,usb
     sdio or spi
config ATBM_USB_BUS
    bool "usb bus"
    help
     usb bus
config ATBM_SDIO_BUS
    bool "sdio bus"
    help
     sdio bus
config ATBM_SPI_BUS
    bool "spi bus"
    help
     spi bus
endchoice

choice
    prompt "select which mode will be used for firmware download"
    default ATBM_USE_FIRMWARE_BIN
    help
     Here,you must make sure which mode you will want to use,bin
     or header file
config ATBM_USE_FIRMWARE_BIN
    bool "firmware bin"
    help
     firmware bi
config ATBM_USE_FIRMWARE_H
    bool "firmware header file"
    help
     firmware header file
endchoice


menu "Driver Extern Function Select"

config ATBM_SUPPORT_BRIDGE
	bool "Enable bridge function"
    default n
config ATBM_FUNC_NOTXCONFIRM
	bool "Enable no_txconfirm"
    default n
config ATBM_FUNC_EARLYSUSPEND
	bool "Enable early suspend"
    default n
config ATBM_FUNC_MONITOR
	bool "Enable monitor"
    default y
config ATBM_FUNC_SKB_DEBUG
    bool "Enable skb debug function to debug skb alloc and free"
    default n
config ATBM_FUNC_MEM_DEBUG
    bool "Enable memory debug function to debug memory alloc and free"
    default n

config ATBM_FUNC_CHANNEL_5G_PRETEND_2G
	bool "Enable channel 5G pretend 2G"
    default n

config ATBM_SDIO_ATCMD
    bool "Enable sdio bus atcmd mode"
    default n

endmenu


menu "Driver debug features"

config ATBM_APOLLO_DEBUGFS
	bool "Enable debugfs"
    default n
config ATBM_APOLLO_DEBUG_ON_BOOT
	bool "Enable debug on boot"
    default n
config ATBM_APOLLO_BH_DEBUG
	bool "Enable bh debug"
    default n
config ATBM_APOLLO_WSM_DEBUG
	bool "Enable wsm debug"
    default n
config ATBM_APOLLO_WSM_DUMPS
    bool "Enable wsm dumps"
    default n
config ATBM_APOLLO_WSM_DUMPS_SHORT
    bool "Enable wsm dumps short"
    default n
config ATBM_APOLLO_TXRX_DEBUG
    bool "Enable txrx debug"
    default n
config ATBM_APOLLO_TX_POLICY_DEBUG
    bool "Enable tx policy debug"
    default n
config ATBM_APOLLO_STA_DEBUG
	bool "Enable sta debug"
    default n
config ATBM_APOLLO_DUMP_ON_ERROR
	bool "Enable dump on error"
    default n
endmenu


config ATBM_APOLLO_USE_GPIO_IRQ
    bool "Use GPIO interrupt"
    depends on ATBM_SDIO_BUS
    default n
    help
     Say Y here if you want to include GPIO IRQ support instead of SDIO IRQ.
     if unsure, say N.
config ATBM_APOLLO_WAPI_SUPPORT
	bool "wapi support"
	default n
	help
	 set wapi support
config ATBM_APOLLO_SUPPORT_SGI
	bool "sgi support"
	default y
	help
	 set sgi support
config MAC80211_ATBM_HAS_RC
	bool "mac80211 has rc support"
	default y
	help
	 set mac80211 has rc support
config MAC80211_ATBM_RC_MINSTREL
	bool "mac80211 rc minstrel support"
	default y
	help
	 set mac80211 rc minstrel support
config MAC80211_ATBM_RC_MINSTREL_HT
	bool "mac80211 rc minstrwl ht support"
	default y
	help
	 set mac80211 rc minstrwl ht support
config MAC80211_ATBM_RC_DEFAULT_MINSTREL
	bool "mac80211 rc default minstrel support"
	default y
	help
	 set mac80211 rc default minstrel support

config ATBM_WIFIIF1_NAME
    string "Setting wifi interface 1 name"
    default "wlan%d"
    help
      Set name for wireless interface 1,the length of name is must smaller than 15
config ATBM_WIFIIF2_NAME
    string "Setting wifi interface 2 name"
    default "p2p%d"
    help
      Set name for wireless interface 2,the length of name is must smaller than 15
config ATBM_MODULE_NAME
    string "set module name"
    default "atbm6041_wifi_spi" if  ATBM_SPI_BUS
    default "atbm6041_wifi_sdio" if ATBM_SDIO_BUS
	default "atbm6041_wifi_usb" if ATBM_USB_BUS
    help 
     set name for wifi module
config ATBM_FW_NAME
	string "set fw name"
	default ""
    help
      Set name for wireless fw,the length of name is must smaller than 32
config MAC80211_ATBM_RC_DEFAULT
	string "set default rc"
	default "minstrel_ht"
	help
      Set default rc for wireless,the length of name is must smaller than 15

endif
endif
```

## sysdrv/drv_ko/wifi/atbm6441/atbm_kconf/Kconfig
```kconfig
menuconfig ATBM_MENUCONFIG
       tristate "Atbm Wireless Lan"
       default m

if ATBM_MENUCONFIG
config DRIVER_PATH
	string
	option env="DRIVER_PATH"
source "$DRIVER_PATH/Kconfig"
endif
```

## sysdrv/drv_ko/wifi/atbm6441/atbm_kconf/Kconfig.conf
```kconfig
config  WIRELESS_CONIFG
       tristate "Atbm Wireless "
       depends on ATBM_APOLLO&&m 
```

## sysdrv/drv_ko/wifi/ssv6115/Kconfig
```kconfig
#menu "iComm-semi 6X5X WLAN support"
config SSV6X5X
	tristate "SSV6X5X Wireless driver"
	depends on CFG80211
	---help---
		Enable iComm-semi SSV6X5X WLAN kernel driver.

#endmenu
```

## sysdrv/drv_ko/wifi/ssv6x5x/Kconfig
```kconfig
#menu "iComm-semi 6X5X WLAN support"
config SSV6X5X
	tristate "SSV6X5X Wireless driver"
	depends on MAC80211 && MMC
	help
		Enable iComm-semi SSV6X5X WLAN kernel driver.

#endmenu
```

## sysdrv/source/mcu/rt-thread/applications/Kconfig
```kconfig
menu "RT-Thread application"

config RT_USING_DLMODULE_APP_EXAMPLE
    bool "dlmodule example enable"
    default n
    depends on RT_USING_MODULE
    help
        "Examples for how to use dlmodule"

config RT_USING_LVGL_DEMO
    bool "LVGL Demo enable"
    depends on RT_USING_LITTLEVGL2RTT_V8
    select RT_LV_COLOR_SCREEN_TRANSP
    help
        "LVGL Demo"

choice
    prompt "Display demo select"
    depends on RT_USING_LVGL_DEMO

    config RT_LV_DEMO_MUSIC
        bool "Music demo enable"
        help
            "LVGL Music demo"

    config RT_LV_DEMO_BENCHMARK
        bool "benchmark demo enable"
        help
            "LVGL Benchmark demo"
endchoice

config RT_USING_ROCKCHIP_DEMO
    bool "Rockchip demo select"
    default n

choice
    prompt "Display demo select"
    depends on RT_USING_ROCKCHIP_DEMO

    config RT_USING_ANIMATION1_DEMO
        bool "Animation1 demo enable"
        help
            "Animation demo based on 240x320 panel"

    config RT_USING_ANIMATION2_DEMO
        bool "Animation2 demo enable"
        select RT_USING_PSRAM_HEAP
        help
            "Animation demo based on 320x385 panel"

    config RT_USING_CLOCK_DEMO
        bool "clock demo enable"
        depends on RT_USING_LITTLEVGL2RTT_V7
        help
            "Display clock demo based on 720x1080 panel"

    config RT_USING_CLOCK_DARK
        bool "clock dark enable"
        select RT_USING_DTCM_HEAP
        help
            "Display clock dark based on 720x1080 panel"

    config RT_USING_CLOCK_WHISKEY
        bool "clock whiskey enable"
        select RT_USING_PSRAM_HEAP
        help
            "Display clock dark based on 320x320 panel"

    config RT_USING_LVGL_CLOCK_EXH2020
        bool "clock exh2020 enable"
        depends on RT_USING_LITTLEVGL2RTT_V7
        select RT_USING_PSRAM_HEAP
        help
            "Display clock demo based on 454x454 panel"

    config RT_USING_APP_WEARABLE
        bool "Wearable demo enable"
        depends on RT_USING_LITTLEVGL2RTT_V7
        select RT_USING_PSRAM_HEAP
        select RT_USING_LARGE_HEAP
        help
            "Display wearable demo"

    config RT_USING_RECORDING_PEN_APP
        bool "Recording pen app"
        depends on RT_USING_LITTLEVGL2RTT_V7
        select RT_USING_AUDIO_SERVER
        help
            Enable recording pen app

    config RT_USING_IOT_DISPLAY
        bool "IoT display enable"
        depends on RT_USING_LITTLEVGL2RTT_V7
        help
            "Display clock & IoT strings based on 240x320 panel"

    config RT_USING_PCBA_TEST
        bool "pcba test enable"
        default n
        depends on RT_USING_LITTLEVGL2RTT_V7
        select RT_USING_AUDIO_SERVER
        help
            Enable PCBA test with LCD display

endchoice

if RT_USING_RECORDING_PEN_APP
    source "$RTT_DIR/applications/recording_pen/Kconfig"
endif

if RT_USING_APP_WEARABLE
    config APP_USING_SMOOTH_REFRESH
        bool "App wearable smooth refresh"
        default n
        help
            App wearable using smooth refresh when sliding.
endif

if RT_USING_LVGL_CLOCK_EXH2020
    config NEW_ROTATE_ALGORITHM
        bool "Using new rotate algorithm"
        default y
endif

if RT_USING_PCBA_TEST
    source "$RTT_DIR/applications/pcba_test/Kconfig"
endif

config RT_USING_RK_BATTERY_IPC
    bool "rk batter ipc app"
    default n

if RT_USING_RK_BATTERY_IPC
menu "RT-Thread Application Rockchip Battery IPC"
config RT_USING_META_DDR_ADRESS
    hex "meta ddr phy address"
    default 0x800000
    depends on RT_USING_RK_BATTERY_IPC

config RT_USING_RK_AOV
    bool "rk fast wakeup"
    default n
    depends on RT_USING_RK_BATTERY_IPC

endmenu
endif

config RT_USING_RK_IOT_APP
    bool "rk iot app"
    select RT_USING_PLAYER
    select RT_USING_LWIP
    default n

    if RT_USING_RK_IOT_APP
        config PRJCONF_SYSINFO_SAVE_TO_FLASH
            bool "system info save to flash"
            default y

        config PRJCONF_BOOT_AUTOMATICALLY
            bool "boot app automatically"
            default n

        config PRJCONF_NET_EN
            bool "network and wlan enable"
            default n

        config PRJCONF_USING_AISPEECH
            bool "Enable aispeech"
            default n

        config PRJCONF_USING_AISPEECH_VAD
            depends on PRJCONF_USING_AISPEECH
            bool "Enable aispeech vad"
            default n

        choice
            prompt "Select asr wake up mode"
            default PRJCONF_AI_RK

            config PRJCONF_AI_RK
                bool "use xiaodu wake up words"
            config PRJCONF_AI_SPEECH
                bool "use speech wake up words"
            config PRJCONF_AI_CUSTOM
                bool "use custom wake up words"
            config PRJCONF_AI_LWAKEUP
                bool "use lite wake up words"
        endchoice

        config PRJCONF_PLAYBACK_SOUND_CARD
            string "Playback sound card"
            default "es8388p"
            help
                Set playback sound card name

        config PRJCONF_ASR_SOUND_CARD
            string "ASR sound card"
            default "pdmc"
            help
                Set ASR sound card name

        config PRJCONF_ASR_USE_VAD
            bool "dsp get data through vad path"
            default n
            help
                dsp get record data through VAD or through CM4 path.
    endif

source "$RTT_DIR/applications/dual_track/Kconfig"

endmenu
```

## sysdrv/source/mcu/rt-thread/applications/dual_track/Kconfig
```kconfig
config ENABLE_DUAL_TRACKING
    bool "Enable dual-tracking"
    default n
    select RT_USING_AUDIO_SERVER
    select AUDIO_ENABLE_RECORDER
    help
        Enable dual-tracking, requires two sound cards that can record simultaneously

    if ENABLE_DUAL_TRACKING
        config ENABLE_DUAL_TRACKING_TEST
            bool "Enable dual-tracking test"
            default n
            help
                A dual-tracking demo
    endif
```

## sysdrv/source/mcu/rt-thread/applications/pcba_test/Kconfig
```kconfig
config PCBA_CAPTURE_SOUND_CARD
    string "Recording sound card"
    default "pdmc"
    help
        Set recording sound card name

config PCBA_PLAYBACK_SOUND_CARD
    string "Playback sound card"
    default "es8388p"
    help
        Set playback sound card name

config PCBA_RECORD_FILE_DIR
    string "Recording file path"
    default "/pcba_test"
    help
        Set where to save recording file

config PCBA_RECORD_FILE_TYPE
    string "Recordind file type"
    default "wav"
    help
        Set which type of recording encorder
```

## sysdrv/source/mcu/rt-thread/applications/recording_pen/Kconfig
```kconfig
config RECPEN_CAPTURE_SOUND_CARD
    string "Recording sound card"
    default "pdmc"
    help
        Set recording sound card name

config RECPEN_PLAYBACK_SOUND_CARD
    string "Playback sound card"
    default "es8388p"
    help
        Set playback sound card name

config RECPEN_RECORD_FILE_DIR
    string "Recording file path"
    default "/record"
    help
        Set where to save recording file

config RECPEN_RECORD_FILE_TYPE
    string "Recordind file type"
    default "wav"
    help
        Set which type of recording encorder

config RECPEN_RECORD_MAX_DURATION
    int "Max recording time(minutes)"
    default 300
    help
        Limit max recording time in minutes, 0 for no limit
```

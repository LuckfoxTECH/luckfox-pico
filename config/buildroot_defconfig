## sysdrv/source/mcu/rt-thread/bsp/rockchip/common/drivers/audio/codecs/Kconfig
```kconfig
config RT_USING_CODEC
    bool
    default n

    config RT_USING_ACDCDIG
        depends on RT_USING_CODEC
        bool

    config RT_USING_ACODEC
        depends on RT_USING_CODEC
        bool

    config RT_USING_CODEC_AW8896
        depends on RT_USING_CODEC
        bool

    config RT_USING_CODEC_ES7243
        depends on RT_USING_CODEC
        bool

    config RT_USING_CODEC_ES8156
        depends on RT_USING_CODEC
        bool

    config RT_USING_CODEC_ES8311
        depends on RT_USING_CODEC
        bool

    config RT_USING_CODEC_ES8388
        depends on RT_USING_CODEC
        bool

    config RT_USING_CODEC_TDA7803
        depends on RT_USING_CODEC
        bool
```

## sysdrv/source/mcu/rt-thread/bsp/rockchip/common/drivers/audio/pcm/Kconfig
```kconfig
menuconfig RT_USING_DRIVER_AUDIO_PCM_PLUGIN
    bool "Audio PCM Plugins"
    default n

if RT_USING_DRIVER_AUDIO_PCM_PLUGIN
    config RT_USING_DRIVER_AUDIO_PCM_PLUGIN_HW
        bool "Enable PCM Hardware Plugin"
        default n

    config RT_USING_DRIVER_AUDIO_PCM_PLUGIN_SOFTVOL
        bool "Enable PCM Softvol Plugin"
        select RT_USING_DRIVER_AUDIO_PCM_PLUGIN_HW
        default n
        help
          Say Y if you would like to use softvol plugin.

    menu "PCM Softvol Configuration"
        depends on RT_USING_DRIVER_AUDIO_PCM_PLUGIN_SOFTVOL
        config SOFTVOL_MIN_DB
            string "PCM Softvol Plugin min dB"
            default "-50.0"
        config SOFTVOL_MAX_DB
            string "PCM Softvol Plugin max dB"
            default "0.0"
        config SOFTVOL_FORMAT
            string "PCM Softvol Plugin format"
            default "S16_LE"
        config SOFTVOL_CHANNELS
            int "PCM Softvol Plugin channels"
            default 2
        config SOFTVOL_RESOLUTION
            int "PCM Softvol Plugin resolution"
            default 100
    endmenu
endif
```

## sysdrv/source/mcu/rt-thread/bsp/rockchip/common/fwmgr/Kconfig
```kconfig
config RT_USING_FWANALYSIS
    bool "Enable firmware analysis"
    default n
    help
        Select this option to enable firmware analysis
```

## sysdrv/source/mcu/rt-thread/bsp/rockchip/common/hal/project/rk3308/Image/amp_linux.its
```
/* SPDX-License-Identifier: BSD-3-Clause */
/*
 * Copyright (c) 2023 Rockchip Electronics Co., Ltd.
 */

/dts-v1/;
/ {
	description = "FIT source file for rockchip AMP";
	#address-cells = <1>;

	images {
		amp3 {
			description  = "bare-mental-core3";
			data         = /incbin/("hal3.bin");
			type         = "firmware";
			compression  = "none";
			arch         = "arm";
			cpu          = <0x3>;
			thumb        = <0>;
			hyp          = <0>;
			load         = <0x02e00000>;
			udelay       = <10000>;
			hash {
				algo = "sha256";
			};
		};
	};

	configurations {
		default = "conf";
		conf {
			description = "Rockchip AMP images";
			rollback-index = <0x0>;
			loadables = "amp3";

			signature {
				algo = "sha256,rsa2048";
				padding = "pss";
				key-name-hint = "dev";
				sign-images = "loadables";
			};

			/* - run linux on cpu0
			 * - it is brought up by amp(that run on U-Boot)
			 * - it is boot entry depends on U-Boot
			 */
			linux {
				description  = "linux-os";
				arch         = "arm64";
				cpu          = <0x0>;
				thumb        = <0>;
				hyp          = <0>;
				udelay       = <0>;
			};
		};
	};
};
```

## sysdrv/source/mcu/rt-thread/bsp/rockchip/common/hal/project/rk3562/Image/amp.its
```
/* SPDX-License-Identifier: BSD-3-Clause */
/*
 * Copyright (c) 2023 Rockchip Electronics Co., Ltd.
 */

/dts-v1/;
/ {
	description = "FIT source file for rockchip AMP";
	#address-cells = <1>;

	images {

		amp0 {
			description  = "bare-mental-core0";
			data         = /incbin/("hal0.bin");
			type         = "firmware";
			compression  = "none";
			arch         = "arm";	 // "arm64" or "arm"
			cpu          = <0x0>;    // mpidr
			thumb        = <0>;      // 0: arm or thumb2; 1: thumb
			hyp          = <0>;      // 0: el1/svc; 1: el2/hyp
			load         = <0x02000000>;
			udelay       = <10000>;
			hash {
				algo = "sha256";
			};
		};

		amp1 {
			description  = "bare-mental-core1";
			data         = /incbin/("hal1.bin");
			type         = "firmware";
			compression  = "none";
			arch         = "arm";
			cpu          = <0x1>;
			thumb        = <0>;
			hyp          = <0>;
			load         = <0x00800000>;
			udelay       = <10000>;
			hash {
				algo = "sha256";
			};
		};

		amp2 {
			description  = "bare-mental-core2";
			data         = /incbin/("hal2.bin");
			type         = "firmware";
			compression  = "none";
			arch         = "arm";
			cpu          = <0x2>;
			thumb        = <0>;
			hyp          = <0>;
			load         = <0x01000000>;
			udelay       = <10000>;
			hash {
				algo = "sha256";
			};
		};

		amp3 {
			description  = "bare-mental-core3";
			data         = /incbin/("hal3.bin");
			type         = "firmware";
			compression  = "none";
			arch         = "arm";
			cpu          = <0x3>;
			thumb        = <0>;
			hyp          = <0>;
			load         = <0x01800000>;
			udelay       = <10000>;
			hash {
				algo = "sha256";
			};
		};
	};

	configurations {
		default = "conf";
		conf {
			description = "Rockchip AMP images";
			rollback-index = <0x0>;
			loadables = "amp0", "amp1", "amp2", "amp3";

			signature {
				algo = "sha256,rsa2048";
				padding = "pss";
				key-name-hint = "dev";
				sign-images = "loadables";
			};
		};
	};
};
```

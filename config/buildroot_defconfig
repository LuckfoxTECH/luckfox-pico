## project/sfc_scripts/boot4recovery.its
```
/*
 * Copyright (C) 2022 Rockchip Electronics Co., Ltd
 *
 * SPDX-License-Identifier: GPL-2.0
 */

/dts-v1/;
/ {
    description = "U-Boot FIT source file for arm";

    images {
        fdt {
            data = /incbin/("kernel/xxx.dtb");
            type = "flat_dt";
            arch = "arm";
            compression = "none";
            load = <0xffffff00>;

            hash {
                algo = "sha256";
            };
        };

        kernel {
            data = /incbin/("kernel/zImage");
            type = "kernel";
            arch = "arm";
            os = "linux";
            compression = "none";
            entry = <0xffffff01>;
            load = <0xffffff01>;

            hash {
                algo = "sha256";
            };
        };

		ramdisk {
			data = /incbin/("out/ramdisk");
			type = "ramdisk";
			arch = "arm";
			os = "linux";
			compression = "none";
			load = <0xffffff02>;

			hash {
				algo = "sha256";
			};
		};

        resource {
            data = /incbin/("kernel/resource.img");
            type = "multi";
            arch = "arm";
            compression = "none";

            hash {
                algo = "sha256";
            };
        };
    };

    configurations {
        default = "conf";

        conf {
            rollback-index = <0x00>;
            fdt = "fdt";
            kernel = "kernel";
            ramdisk = "ramdisk";
            multi = "resource";

            signature {
                algo = "sha256,rsa2048";
                padding = "pss";
                key-name-hint = "dev";
                sign-images = "fdt", "kernel", "ramdisk", "multi";
            };
        };
    };
};
```

## project/sfc_scripts/rv1106-boot-tb-ramdisk.its
```
/*
 * Copyright (C) 2022 Rockchip Electronics Co., Ltd
 *
 * SPDX-License-Identifier: GPL-2.0
 */

/dts-v1/;
/ {
	description = "FIT source file for Linux";
	#address-cells = <1>;

	images {
		ramdisk {
			data = /incbin/("./images-tb/ramdisk");
			compression = "gzip";
			type = "ramdisk";
			arch = "arm";
			os = "linux";
			preload = <1>;
			comp = <ramdisk_c>;
			load  = <ramdisk_r>;
			decomp-async;
			hash {
				algo = "sha256";
				uboot-ignore = <1>;
			};
		};
	};

	configurations {
		default = "conf";
		conf {
			description = "Fit ramdisk";
			rollback-index = <0x0>;
			ramdisk = "ramdisk";
			signature {
				algo = "sha256,rsa2048";
				padding = "pss";
				key-name-hint = "dev";
				sign-images = "ramdisk";
			};
		};
	};
};
```

## project/sfc_scripts/rv1126-boot-tb.its
```
/*
 * Copyright (C) 2022 Rockchip Electronics Co., Ltd
 *
 * SPDX-License-Identifier: GPL-2.0
 */

/dts-v1/;
/ {
	description = "FIT source file for Linux";
	#address-cells = <1>;

	images {
		fdt {
			data = /incbin/("./images-tb/rk-kernel.dtb");
			type = "flat_dt";
			arch = "arm";
			compression = "none";
			load  = <0x01f00000>;
			hash {
				algo = "sha256";
				uboot-ignore = <1>;
			};
		};

		kernel {
			data = /incbin/("./images-tb/kernel");
			compression = "gzip";
			type = "kernel";
			arch = "arm";
			os = "linux";
			comp = <kernel_c>;
			entry = <0x608000>;
			load  = <0x608000>;
			hash {
				algo = "sha256";
				uboot-ignore = <1>;
			};
		};

		ramdisk {
			data = /incbin/("./images-tb/ramdisk");
			compression = "gzip";
			type = "ramdisk";
			arch = "arm";
			os = "linux";
			preload = <1>;
			comp = <ramdisk_c>;
			load  = <ramdisk_r>;
			decomp-async;
			hash {
				algo = "sha256";
				uboot-ignore = <1>;
			};
		};

		resource {
			data = /incbin/("./images-tb/resource");
			type = "multi";
			arch = "arm";
			compression = "none";
			hash {
				algo = "sha256";
				uboot-ignore = <1>;
			};
		};
	};

	configurations {
		default = "conf";
		conf {
			description = "Boot Linux kernel with FDT blob";
			rollback-index = <0x0>;
			fdt = "fdt";
			kernel = "kernel";
			ramdisk = "ramdisk";
			multi = "resource";
			signature {
				algo = "sha256,rsa2048";
				padding = "pss";
				key-name-hint = "dev";
				sign-images = "fdt", "kernel", "ramdisk", "multi";
			};
		};
	};
};
```

## sysdrv/drv_ko/wifi/aic8800_netdrv/Kconfig
```kconfig
config AIC8800_NETDRV_SUPPORT
    tristate "AIC8800 NETDRV Support"
    default y
    ---help---
        This is support for AIC vnet driver
```

## sysdrv/drv_ko/wifi/aic8800dc/Kconfig
```kconfig
config AIC_WLAN_SUPPORT
	bool "AIC wireless Support"
	default n
	help
	  This is support for aic wireless chip.

config AIC_FW_PATH
	depends on AIC_WLAN_SUPPORT
	string "Firmware & config file path"
	#default "/vendor/etc/firmware"
	#default "/lib/firmware/aic8800_sdio"
	default "/oem/usr/ko/aic8800dc_fw"
	help
	  Path to the firmware & config file.

if AIC_WLAN_SUPPORT
source "drivers/net/wireless/aic8800/aic8800_fdrv/Kconfig"
source "drivers/net/wireless/aic8800/aic8800_btlpm/Kconfig"
endif
```

## sysdrv/drv_ko/wifi/aic8800dc/aic8800_btlpm/Kconfig
```kconfig
config AIC8800_BTLPM_SUPPORT
	tristate "AIC8800 bluetooth Support"
	help
	  This is support for aic bluetooh driver.
```

## sysdrv/drv_ko/wifi/aic8800dc/aic8800_fdrv/Kconfig
```kconfig
config AIC8800_WLAN_SUPPORT
	tristate "AIC8800 wlan Support"
	help
	  This is support for aic wifi driver.
```
